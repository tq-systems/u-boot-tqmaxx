## board/tq/common/Kconfig
```kconfig
# SPDX-License-Identifier: GPL-2.0-or-later
#
# Copyright (c) 2023-2026 TQ-Systems GmbH <u-boot@ew.tq-group.com>,
# D-82229 Seefeld, Germany.
# Author: Markus Niebel, Max Merchel
#

config TQ_COMMON_BB
	bool
	default y

config TQ_COMMON_EEPROM
	bool
	select DM_I2C
	select I2C_EEPROM

if TQ_COMMON_EEPROM

config TQ_COMMON_EEPROM_OFFSET
	hex
	default 0x1000 if TARGET_TQMA8MPXS
	default 0x0

endif

config TQ_COMMON_SDMMC
	bool

config TQ_COMMON_SOM
	bool

#
# This should be selected by boards that wish to support multiple env locations
# select ENV_IS_NOWHERE to use as default if nothing matches.
#
config TQ_COMMON_ENVLOC
	bool
	select ENV_IS_NOWHERE

config TQ_COMMON_SPI_NOR
	bool
	default y if (SPI_FLASH && OF_BOARD_SETUP)

config TQ_COMMON_VARD
	bool
	select HASH
	select SPL_HASH if SPL
	select TQ_COMMON_EEPROM

config TQ_COMMON_TCPC
	bool "USB Type-C port controller simple driver"
	help
	  Enable NXP USB Type-C port controller (TCPC) driver.
	  This supports Type-C direction detection and role switching
	  with NXP PTN5110 IC.
```

## board/tq/tqma8mpxs/Kconfig
```kconfig
if TARGET_TQMA8MPXS

config SYS_BOARD
	default "tqma8mpxs"

config SYS_VENDOR
	default "tq"

config SYS_CONFIG_NAME
	default "tqma8mpxs"

config IMX_CONFIG
	default "board/nxp/imx8mp_evk/imximage-8mp-lpddr4.cfg"

config TQMA8MPXS_DEFAULTS
	bool
	default y
	select TQ_COMMON_BB
	select TQ_COMMON_EEPROM
	select TQ_COMMON_SDMMC
	select TQ_COMMON_SPI_NOR if SPI_FLASH
	select TQ_COMMON_VARD
	imply FSL_CAAM
	imply SPL_CRYPTO if SPL
	select I2C_EEPROM
	select SPL_I2C_EEPROM if SPL
	select GPIO_HOG
	imply MISC
	imply ENV_IS_NOWHERE
	imply SYS_REDUNDAND_ENVIRONMENT
	imply ENV_OVERWRITE
	imply OF_UPSTREAM

choice
	prompt "TQMa8MPxS RAM configuration"
	default TQMA8MPXS_RAM_MULTI
	help
	  Select RAM configuration. Normally use default here but for
	  specific setup it is possible to use a single RAM size.

config TQMA8MPXS_RAM_MULTI
	bool "TQMa8MPxS with 1/2/4/8 GB RAM - Single image"
	select TQMA8MPXS_RAM_1024MB
	select TQMA8MPXS_RAM_2048MB
	select TQMA8MPXS_RAM_4096MB
	select TQMA8MPXS_RAM_8192MB
	select BLOBLIST
	select SPL_BLOBLIST
	help
	  Build a single U-Boot for variants with 1/2/4/8 GB RAM. Select whether to use
	  the inline ECC capability or not using config item IMX8M_DRAM_INLINE_ECC

#
# When compiling for a single product using only one SoM variant, an alternate config
# supporting only a single RAM configuration may be added.
#

endchoice

config TQMA8MPXS_RAM_1024MB
	bool

config TQMA8MPXS_RAM_2048MB
	bool

config TQMA8MPXS_RAM_4096MB
	bool

config TQMA8MPXS_RAM_8192MB
	bool

choice
	prompt "TQMa8MPxS base board variant"
	default TQMA8MPXS_BB_MB_SMARC_2
	help
	  The TQ-Systems GmbH TQMa8MPxS SoM needs a baseboard.
	  Select a base board for TQMa8MPxS SoM based machine.

config TQMA8MPXS_BB_MB_SMARC_2
	bool "TQMa8MPxS on MB_SMARC_2 Board"
	help
	  Select the MB_SMARC_2 board for TQMa8MPxS board.
	  This features most interfaces the CPU can provide.

endchoice

source "board/tq/common/Kconfig"

endif
```

## configs/tqma8mpxs_multi_mb_smarc_2_defconfig
```kconfig
#include <configs/tqma8mpxs_mb_smarc_2.config>
CONFIG_ENV_IS_IN_MMC=y
CONFIG_ENV_IS_IN_SPI_FLASH=y
```
