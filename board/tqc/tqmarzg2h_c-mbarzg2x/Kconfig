## board/tqc/tqmarzg2h_c-mbarzg2x/Kconfig
```kconfig
if TARGET_TQMARZG2H_C_MBARZG2X

config SYS_SOC
	default "rmobile"

config SYS_BOARD
	default "tqmarzg2h_c-mbarzg2x"

config SYS_VENDOR
	default "tqc"

config SYS_CONFIG_NAME
	default "tqmarzg2h_c-mbarzg2x"

source "board/tqc/common/Kconfig"

endif
```

## board/tqc/tqmarzg2m_aa-mbarzg2x/Kconfig
```kconfig
if TARGET_TQMARZG2M_AA_MBARZG2X

config SYS_SOC
	default "rmobile"

config SYS_BOARD
	default "tqmarzg2m_aa-mbarzg2x"

config SYS_VENDOR
	default "tqc"

config SYS_CONFIG_NAME
	default "tqmarzg2m_aa-mbarzg2x"

source "board/tqc/common/Kconfig"

endif
```

## board/tqc/tqmarzg2n_b-mbarzg2x/Kconfig
```kconfig
if TARGET_TQMARZG2N_B_MBARZG2X

config SYS_SOC
	default "rmobile"

config SYS_BOARD
	default "tqmarzg2n_b-mbarzg2x"

config SYS_VENDOR
	default "tqc"

config SYS_CONFIG_NAME
	default "tqmarzg2n_b-mbarzg2x"

source "board/tqc/common/Kconfig"

endif
```

## board/tqc/tqmarzg2x/Kconfig
```kconfig
if TARGET_TQMARZG2X

config SYS_SOC
	default "rmobile"

config SYS_BOARD
	default "tqmarzg2x"

config SYS_VENDOR
	default "tqc"

config SYS_CONFIG_NAME
	default "tqmarzg2x"

choice
	prompt "TQMaRZG2x SoC variant"
	default TQMARZG2M
	help
	  select the TQMaRZG2x module variant. The variants differing in the used
	  RZ/G2 CPU type and DRAM

config TQMARZG2M
	bool "TQMaRZG2M"
	depends on R8A774A1
	help
	  select TQMaRZG2M with R8A774A1 and 2GiB DRAM

config TQMARZG2N
	bool "TQMaRZG2N"
	depends on R8A774B1
	help
	  select TQMaRZG2N with R8A774B1 and 2GiB DRAM

config TQMARZG2H
	bool "TQMaRZG2H"
	depends on R8A774E1
	help
	  select TQMaRZG2H with R8A774E1 and 4GiB DRAM

endchoice

choice
	prompt "TQMaRZG2x base board variant"
	default MBARZG2X
	help
	  Select base board for TQMaRZG2x

config MBARZG2X
	bool "TQMaRZG2x on MBaRZG2x Starterkit"
	select TQC_EEPROM
	select DM_ETH
	select CMD_USB
	select USB
	select USB_XHCI_HCD
	select USB_EHCI_HCD
	select USB_EHCI_GENERIC
	select USB_STORAGE
	select PHY_TI
	help
	  Select the MBaRZG2x starterkit.

endchoice

endif

source "board/tqc/common/Kconfig"
```

## board/tqc/tqmls1012al/Kconfig
```kconfig
# SPDX-License-Identifier: GPL-2.0+
#
# Copyright (C) 2022 TQ-Systems GmbH
#

if TARGET_TQMLS1012AL

config SYS_BOARD
	default "tqmls1012al"

config SYS_VENDOR
	default "tqc"

config SYS_SOC
	default "fsl-layerscape"

config SYS_CONFIG_NAME
	default "tqmls1012al"

choice
	prompt "TQMLS1012AL base board variant"
	default MBLS1012AL
	help
	  Select base board for TQMLS1012AL module

config MBLS1012AL
	bool "TQMLS1012AL on MBLS1012AL Starterkit"
	help
	  Select the MBLS1012AL starterkit.
	  This features Ethernet, USB, SD-Card, etc.

endchoice

choice
	prompt "TQMLS1012AL MMC variant"
	default TQMLS1012AL_SD
	help
	  Select expansion device variant for TQMLS1012AL module

config TQMLS1012AL_SD
	bool "TQMLS1012AL with SD card"
	help
	  Select the TQMLS1012AL module with external SD card and without
	  e-MMC.

config TQMLS1012AL_EMMC
	bool "TQMLS1012AL with eMMC"
	help
	  Select the TQMLS1012AL module with eMMC.

endchoice

if FSL_PFE

config SYS_LS_PFE_FW_ADDR
	hex "Flash offset of PFE firmware"
	default 0xa00000 if MBLS1012AL

config SYS_LS_PFE_FW_LENGTH
	hex "length of PFE firmware"
	default 0x300000

config DDR_PFE_PHYS_BASEADDR
	hex "PFE DDR physical base address"
	default 0x03400000

config DDR_PFE_BASEADDR
	hex "PFE DDR base address"
	default 0x83400000

config PFE_EMAC1_PHY_ADDR
	hex "PFE PHY1 address"
	default 0x9

config PFE_EMAC2_PHY_ADDR
	hex "PFE PHY2 address"
	default 0x1

endif

source "board/tqc/common/Kconfig"
source "board/freescale/common/Kconfig"

endif
```

## board/tqc/tqmls1028a/Kconfig
```kconfig
if TARGET_TQMLS1028A

config SYS_BOARD
	default "tqmls1028a"

config SYS_VENDOR
	default "tqc"

config SYS_SOC
	default "fsl-layerscape"

config SYS_CONFIG_NAME
	default "tqmls1028a"

choice
	prompt "TQMLS1028A base board variant"
	default MBLS1028A
	help
	  Select base board for TQMLS1028A module

config MBLS1028A
	bool "TQMLS1028A on MBLS1028A Starterkit"
	select DM_GPIO
	help
	  Select the MBLS1028A starterkit.
	  This features a Ethernet, USB, SD-Card, etc.

config MBLS1028A_IND
	bool "TQMLS1028A on MBLS1028A-IND Board"
	select DM_GPIO
	help
	  Select the MBLS1028A industrial starterkit.
	  This features a Ethernet, USB, SD-Card, etc.
	  on a smaller board.
endchoice

config SYS_TEXT_BASE
	default 0x82000000

source "board/tqc/common/Kconfig"

endif
```

## board/tqc/tqmls102xa/Kconfig
```kconfig
if TARGET_TQMLS102XA

config SYS_BOARD
	default "tqmls102xa"

config SYS_VENDOR
	default "tqc"

config SYS_SOC
	default "ls102xa"

config SYS_CONFIG_NAME
	default "tqmls102xa"

choice
	prompt "Memory configuration"
	default SYS_1G_CS0

config SYS_1G_CS0
	bool "1 GiB on CS0"

config SYS_2G_CS0CS1
	bool "2 GiB on CS0 and CS1"

endchoice

choice
	prompt "CPU clock speed"
	default SYS_CPU_1000

config SYS_CPU_1000
	bool "1000 MHz"

config SYS_CPU_1200
	bool "1200 MHz"

endchoice

choice
	prompt "Base board variant"
	optional
	help
	  Select base board for TQMLS102xA module

config TQMLS102XA_MBLS102XA
	bool "TQMLS102xA on MBLS102xA Starterkit"
	help
	  Select the MBLS102xA starterkit.
	  This features a Ethernet, USB, SD-Card, etc.

endchoice

source "board/tqc/common/Kconfig"

endif

config CMD_CPLD_MUX
	bool "cpld_mux - read MBLS102xA CPLD muxing"
	default y if TQMLS102XA_MBLS102XA
	help
	  This baseboard has a CPLD that muxes peripheral interfaces
	  depending on four GPIOs at the CPLD. The GPIOs are readable via
	  an i2c port expander. The function allows testing against a
	  user defined pin mask and when matching allows to execute a
	  user defined shell command."

if CMD_CPLD_MUX
menu "CPLD MUX settings"

config CPLD_MUX_DIP_BUS
	hex "I2C bus to read"
	default 0x0 if TQMLS102XA_MBLS102XA

config CPLD_MUX_DIP_ADDRESS
	hex "I2C address to read"
	default 0x22 if TQMLS102XA_MBLS102XA

config CPLD_MUX_DIP_REGISTER
	hex "Register to read from I2C address"
	default 0x0 if TQMLS102XA_MBLS102XA

config CPLD_MUX_DIP_MASK
	hex "Bitmask to compare against"
	default 0x08 if TQMLS102XA_MBLS102XA

config CPLD_MUX_MATCH_COMMAND
	string "Command to run on match"
	default "setenv bootargs ${bootargs} video=HDMI-A-1:d video=LVDS-1:800x480-32" if TQMLS102XA_MBLS102XA

endmenu
endif
```

## board/tqc/tqmls1043a/Kconfig
```kconfig
if TARGET_TQMLS1043A

config SYS_BOARD
	default "tqmls1043a"

config SYS_VENDOR
	default "tqc"

config SYS_SOC
	default "fsl-layerscape"

config SYS_CONFIG_NAME
	default "tqmls1043a"

config TQMLS1043A_DDR_2G
	bool "TQMLS1043A with 2GB DDR size"
	default n

source "board/tqc/tqmls1043a/pbi_rcw/Kconfig"

choice
	prompt "TQMLS1043A base board variant"
	default TQMLS1043A_BB_MBLS10XXA
	help
	  Select base board for TQMLS1043A

config TQMLS1043A_BB_MBLS10XXA
	bool "TQMLS1043A on MBLS10xxA Starterkit"
	select TQC_MBLS10XXA
	help
	  Select the MBLS10XXA starterkit.

endchoice

if FSL_LS_PPA
config SYS_LS_PPA_FW_ADDR
	hex "PPA Firmware Addr"
	default 0x40400000 if SYS_LS_PPA_FW_IN_XIP && QSPI_BOOT
	default 0x400000 if SYS_LS_PPA_FW_IN_MMC

if CHAIN_OF_TRUST
config SYS_LS_PPA_ESBC_ADDR
	hex "PPA Firmware HDR Addr"
	default 0x40680000 if SYS_LS_PPA_FW_IN_XIP && QSPI_BOOT
	default 0x680000 if SYS_LS_PPA_FW_IN_MMC
endif
endif

source "board/tqc/common/Kconfig"

endif
```

## board/tqc/tqmls1043a/pbi_rcw/Kconfig
```kconfig
if TARGET_TQMLS1043A

choice
	prompt "TQMLS1043A RCW configuration file"
	default TQMLS1043A_RCW_3358
	help
	  Select the RCW configuration file to be used for TQMLS1043A

config TQMLS1043A_RCW_1355
	bool "TQMLS1043A RCW configuration for SERDES mode 1355"
	help
	  Select SERDES mode 1355 in reset configuration word

config TQMLS1043A_RCW_3335
	bool "TQMLS1043A RCW configuration for SERDES mode 3335"
	help
	  Select SERDES mode 3335 in reset configuration word

config TQMLS1043A_RCW_3355
	bool "TQMLS1043A RCW configuration for SERDES mode 3355"
	help
	  Select SERDES mode 3355 in reset configuration word

config TQMLS1043A_RCW_3358
	bool "TQMLS1043A RCW configuration for SERDES mode 3358 (default)"
	help
	  Select SERDES mode 3358 in reset configuration word

config TQMLS1043A_RCW_1455
	bool "TQMLS1043A RCW configuration for SERDES mode 1455"
	help
	  Select SERDES mode 1455 in reset configuration word

endchoice

config SYS_FSL_PBL_RCW
	string
	default "board/tqc/tqmls1043a/pbi_rcw/tqmls1043a_rcw_sd_1355.cfg" \
	  if TQMLS1043A_RCW_1355 && SD_BOOT
	default "board/tqc/tqmls1043a/pbi_rcw/tqmls1043a_rcw_qspi_1355.cfg" \
	  if TQMLS1043A_RCW_1355 && QSPI_BOOT
	default "board/tqc/tqmls1043a/pbi_rcw/tqmls1043a_rcw_sd_3335.cfg" \
	  if TQMLS1043A_RCW_3335 && SD_BOOT
	default "board/tqc/tqmls1043a/pbi_rcw/tqmls1043a_rcw_qspi_3335.cfg" \
	  if TQMLS1043A_RCW_3335 && QSPI_BOOT
	default "board/tqc/tqmls1043a/pbi_rcw/tqmls1043a_rcw_sd_3355.cfg" \
	  if TQMLS1043A_RCW_3355 && SD_BOOT
	default "board/tqc/tqmls1043a/pbi_rcw/tqmls1043a_rcw_qspi_3355.cfg" \
	  if TQMLS1043A_RCW_3355 && QSPI_BOOT
	default "board/tqc/tqmls1043a/pbi_rcw/tqmls1043a_rcw_sd_3358.cfg" \
	  if TQMLS1043A_RCW_3358 && SD_BOOT
	default "board/tqc/tqmls1043a/pbi_rcw/tqmls1043a_rcw_qspi_3358.cfg" \
	  if TQMLS1043A_RCW_3358 && QSPI_BOOT
	default "board/tqc/tqmls1043a/pbi_rcw/tqmls1043a_rcw_sd_1455.cfg" \
	  if TQMLS1043A_RCW_1455 && SD_BOOT
	default "board/tqc/tqmls1043a/pbi_rcw/tqmls1043a_rcw_qspi_1455.cfg" \
	  if TQMLS1043A_RCW_1455 && QSPI_BOOT

config SYS_FSL_PBL_PBI
	string
	default "board/tqc/tqmls1043a/pbi_rcw/tqmls1043a_pbi_sd.cfg" \
	  if SD_BOOT
	default "board/tqc/tqmls1043a/pbi_rcw/tqmls1043a_pbi_qspi.cfg" \
	  if QSPI_BOOT
endif
```

## board/tqc/tqmls1046a/Kconfig
```kconfig
if TARGET_TQMLS1046A

config SYS_BOARD
	default "tqmls1046a"

config SYS_VENDOR
	default "tqc"

config SYS_SOC
	default "fsl-layerscape"

config SYS_CONFIG_NAME
	default "tqmls1046a"

config TQMLS1046A_DDR_8G
	bool "TQMLS1046A with 8GB DDR size"
	default n

config TQMLS1046A_DDR_NO_ECC
	bool "TQMLS1046A without ECC DDR"
	default n

source "board/tqc/tqmls1046a/pbi_rcw/Kconfig"

choice
	prompt "TQMLS1046A base board variant"
	default TQMLS1046A_BB_MBLS10XXA
	help
	  Select base board for TQMLS1046A

config TQMLS1046A_BB_MBLS10XXA
	bool "TQMLS1046A on MBLS10xxA Starterkit"
	select TQC_MBLS10XXA
	help
	  Select the MBLS10XXA starterkit.

endchoice

if FSL_LS_PPA
config SYS_LS_PPA_FW_ADDR
	hex "PPA Firmware Addr"
	default 0x40400000 if SYS_LS_PPA_FW_IN_XIP && QSPI_BOOT
	default 0x400000 if SYS_LS_PPA_FW_IN_MMC

if CHAIN_OF_TRUST
config SYS_LS_PPA_ESBC_ADDR
	hex "PPA Firmware HDR Addr"
	default 0x40680000 if SYS_LS_PPA_FW_IN_XIP && QSPI_BOOT
	default 0x680000 if SYS_LS_PPA_FW_IN_MMC
endif
endif

source "board/tqc/common/Kconfig"


endif
```

## board/tqc/tqmls1046a/pbi_rcw/Kconfig
```kconfig
if TARGET_TQMLS1046A

choice
	prompt "TQMLS1046A RCW configuration file"
	default TQMLS1046A_RCW_3333_5559
	help
	  Select the RCW configuration file to be used for TQMLS1046A

config TQMLS1046A_RCW_1040_5A06
	bool "TQMLS1046A RCW configuration for SERDES mode 1040_5A06"
	help
	  Select SERDES mode 1040_5A06 in reset configuration word

config TQMLS1046A_RCW_1133_5A06
	bool "TQMLS1046A RCW configuration for SERDES mode 1133_5A06"
	help
	  Select SERDES mode 1133_5A06 in reset configuration word

config TQMLS1046A_RCW_3333_5506
	bool "TQMLS1046A RCW configuration for SERDES mode 3333_5506"
	help
	  Select SERDES mode 3333_5506 in reset configuration word

config TQMLS1046A_RCW_3333_5559
	bool "TQMLS1046A RCW configuration for SERDES mode 3333_5559 (default)"
	help
	  Select SERDES mode 3333_5559 in reset configuration word

config TQMLS1046A_RCW_3333_5577
	bool "TQMLS1046A RCW configuration for SERDES mode 3333_5577"
	help
	  Select SERDES mode 3333_5577 in reset configuration word

config TQMLS1046A_RCW_3333_5A06
	bool "TQMLS1046A RCW configuration for SERDES mode 3333_5A06"
	help
	  Select SERDES mode 3333_5A06 in reset configuration word

config TQMLS1046A_RCW_3333_5A59
	bool "TQMLS1046A RCW configuration for SERDES mode 3333_5A59"
	help
	  Select SERDES mode 3333_5A59 in reset configuration word

endchoice

config SYS_FSL_PBL_RCW
	string
	default "board/tqc/tqmls1046a/pbi_rcw/tqmls1046a_rcw_emmc_1040_5A06.cfg" \
	  if TQMLS1046A_RCW_1040_5A06 && SD_BOOT && SYS_TQMLS1046A_EMMC
	default "board/tqc/tqmls1046a/pbi_rcw/tqmls1046a_rcw_sd_1040_5A06.cfg" \
	  if TQMLS1046A_RCW_1040_5A06 && SD_BOOT && !SYS_TQMLS1046A_EMMC
	default "board/tqc/tqmls1046a/pbi_rcw/tqmls1046a_rcw_qspi_1040_5A06.cfg" \
	  if TQMLS1046A_RCW_1040_5A06 && QSPI_BOOT
	default "board/tqc/tqmls1046a/pbi_rcw/tqmls1046a_rcw_emmc_1133_5A06.cfg" \
	  if TQMLS1046A_RCW_1133_5A06 && SD_BOOT && SYS_TQMLS1046A_EMMC
	default "board/tqc/tqmls1046a/pbi_rcw/tqmls1046a_rcw_sd_1133_5A06.cfg" \
	  if TQMLS1046A_RCW_1133_5A06 && SD_BOOT && !SYS_TQMLS1046A_EMMC
	default "board/tqc/tqmls1046a/pbi_rcw/tqmls1046a_rcw_qspi_1133_5A06.cfg" \
	  if TQMLS1046A_RCW_1133_5A06 && QSPI_BOOT
	default "board/tqc/tqmls1046a/pbi_rcw/tqmls1046a_rcw_emmc_3333_5506.cfg" \
	  if TQMLS1046A_RCW_3333_5506 && SD_BOOT && SYS_TQMLS1046A_EMMC
	default "board/tqc/tqmls1046a/pbi_rcw/tqmls1046a_rcw_sd_3333_5506.cfg" \
	  if TQMLS1046A_RCW_3333_5506 && SD_BOOT && !SYS_TQMLS1046A_EMMC
	default "board/tqc/tqmls1046a/pbi_rcw/tqmls1046a_rcw_qspi_3333_5506.cfg" \
	  if TQMLS1046A_RCW_3333_5506 && QSPI_BOOT
	default "board/tqc/tqmls1046a/pbi_rcw/tqmls1046a_rcw_emmc_3333_5559.cfg" \
	  if TQMLS1046A_RCW_3333_5559 && SD_BOOT && SYS_TQMLS1046A_EMMC
	default "board/tqc/tqmls1046a/pbi_rcw/tqmls1046a_rcw_sd_3333_5559.cfg" \
	  if TQMLS1046A_RCW_3333_5559 && SD_BOOT && !SYS_TQMLS1046A_EMMC
	default "board/tqc/tqmls1046a/pbi_rcw/tqmls1046a_rcw_qspi_3333_5559.cfg" \
	  if TQMLS1046A_RCW_3333_5559 && QSPI_BOOT
	default "board/tqc/tqmls1046a/pbi_rcw/tqmls1046a_rcw_emmc_3333_5577.cfg" \
	  if TQMLS1046A_RCW_3333_5577 && SD_BOOT && SYS_TQMLS1046A_EMMC
	default "board/tqc/tqmls1046a/pbi_rcw/tqmls1046a_rcw_sd_3333_5577.cfg" \
	  if TQMLS1046A_RCW_3333_5577 && SD_BOOT && !SYS_TQMLS1046A_EMMC
	default "board/tqc/tqmls1046a/pbi_rcw/tqmls1046a_rcw_qspi_3333_5577.cfg" \
	  if TQMLS1046A_RCW_3333_5577 && QSPI_BOOT
	default "board/tqc/tqmls1046a/pbi_rcw/tqmls1046a_rcw_emmc_3333_5A06.cfg" \
	  if TQMLS1046A_RCW_3333_5A06 && SD_BOOT && SYS_TQMLS1046A_EMMC
	default "board/tqc/tqmls1046a/pbi_rcw/tqmls1046a_rcw_sd_3333_5A06.cfg" \
	  if TQMLS1046A_RCW_3333_5A06 && SD_BOOT && !SYS_TQMLS1046A_EMMC
	default "board/tqc/tqmls1046a/pbi_rcw/tqmls1046a_rcw_qspi_3333_5A06.cfg" \
	  if TQMLS1046A_RCW_3333_5A06 && QSPI_BOOT
	default "board/tqc/tqmls1046a/pbi_rcw/tqmls1046a_rcw_emmc_3333_5A59.cfg" \
	  if TQMLS1046A_RCW_3333_5A59 && SD_BOOT && SYS_TQMLS1046A_EMMC
	default "board/tqc/tqmls1046a/pbi_rcw/tqmls1046a_rcw_sd_3333_5A59.cfg" \
	  if TQMLS1046A_RCW_3333_5A59 && SD_BOOT && !SYS_TQMLS1046A_EMMC
	default "board/tqc/tqmls1046a/pbi_rcw/tqmls1046a_rcw_qspi_3333_5A59.cfg" \
	  if TQMLS1046A_RCW_3333_5A59 && QSPI_BOOT

config SYS_FSL_PBL_PBI
	string
	default "board/tqc/tqmls1046a/pbi_rcw/tqmls1046a_pbi_sd.cfg" \
	  if SD_BOOT
	default "board/tqc/tqmls1046a/pbi_rcw/tqmls1046a_pbi_qspi.cfg" \
	  if QSPI_BOOT
endif
```

## board/tqc/tqmls1088a/Kconfig
```kconfig
if TARGET_TQMLS1088A

config SYS_BOARD
	default "tqmls1088a"

config SYS_VENDOR
	default "tqc"

config SYS_SOC
	default "fsl-layerscape"

config SYS_CONFIG_NAME
	default "tqmls1088a"

choice
	prompt "TQMLS1088A base board variant"
	default TQMLS1088A_BB_MBLS10XXA
	help
	  Select base board for TQMLS1088A

config TQMLS1088A_BB_MBLS10XXA
	bool "TQMLS1088A on MBLS10xxA Starterkit"
	select TQC_MBLS10XXA
	help
	  Select the MBLS10XXA starterkit.

endchoice

if FSL_LS_PPA
config SYS_LS_PPA_FW_ADDR
	hex "PPA Firmware Addr"
	default 0x20400000 if SYS_LS_PPA_FW_IN_XIP && QSPI_BOOT
	default 0x400000 if SYS_LS_PPA_FW_IN_MMC

if CHAIN_OF_TRUST
config SYS_LS_PPA_ESBC_ADDR
	hex "PPA Firmware HDR Addr"
	default 0x20680000 if SYS_LS_PPA_FW_IN_XIP && QSPI_BOOT
	default 0x680000 if SYS_LS_PPA_FW_IN_MMC
endif
endif

source "board/tqc/common/Kconfig"


endif
```
