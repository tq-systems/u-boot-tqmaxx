// SPDX-License-Identifier: GPL-2.0-or-later OR MIT
/*
 * Device Tree Source for U-Boot for the TQMaRZG2N-B module on a MBaRZG2x board
 *
 * Copyright (C) 2019 Renesas Electronisc Corporation
 * Copyright (C) 2021 TQ-Systems GmbH
 */

#include "r8a774b1-tqmarzg2n_b-mbarzg2x.dts"
#include "r8a774b1-u-boot.dtsi"
