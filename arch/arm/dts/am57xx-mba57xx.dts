/*
 * Copyright (C) 2020 TQ-Systems GmbH
 *
 * Author: Michael Krummsdorf <michael.krummsdorf@tq-group.com>
 *
 * This program is free software; you can redistribute it and/or modify
 * it under the terms of the GNU General Public License version 2 as
 * published by the Free Software Foundation.
 */

/dts-v1/;

#include "dra74x.dtsi"
#include "dra74x-mmc-iodelay.dtsi"
#include "am57xx-tqma57xx.dtsi"
#include "am57xx-mba57xx.dtsi"

/ {
	model = "TQ TQMa57xx MBa57xx";
	compatible = "tq,mba57xx", "tq,tqma5728", "ti,am5728",
		     "ti,dra7";

	memory@0 {
		device_type = "memory";
		reg = <0x0 0x80000000 0x0 0x80000000>;
	};
};

&mmc2 {
	pinctrl-2 = <&mmc2_pins_nopu>;
	pinctrl-3 = <&mmc2_pins_modesel_nopu &mmc2_iodelay_hs200_rev20_conf>;
};

&pcie2_phy {
	status = "okay";
};
