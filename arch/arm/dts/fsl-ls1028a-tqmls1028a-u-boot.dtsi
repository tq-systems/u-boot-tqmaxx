// SPDX-License-Identifier: (GPL-2.0-or-later OR MIT)
/*
 * Copyright (c) 2025 TQ-Systems GmbH <u-boot@ew.tq-group.com>,
 * D-82229 Seefeld, Germany.
 * Author: Markus Niebel
 */

/*
 * no generic, CPU specific part of U-Boot modifications
 * for device tree available.
 */

/ {
	aliases {
		i2c0 = &i2c0;
		i2c_eeprom0 = &se97_50;
	};
};

&se97_50 {
	/delete-property/ read-only;
};
