// SPDX-License-Identifier: GPL-2.0-or-later OR MIT
/*
 * Copyright 2018 - 2021 TQ-Systems GmbH
 */

#include "fsl-imx8dxp.dtsi"
#include "tqma8xx.dtsi"

/ {
	model = "TQ-Systems i.MX8DXP TQMa8XDP";
	compatible = "tq,imx8dxp-tqma8xdp", "fsl,imx8dxp", "fsl,imx8qxp";
};
