// SPDX-License-Identifier: GPL-2.0-or-later OR MIT
/*
 * TQ TQMLX2160A u-boot specific device tree source
 *
 * Copyright (c) 2020-2023 TQ-Systems GmbH <u-boot@ew.tq-group.com>,
 * D-82229 Seefeld, Germany.
 * Author: Gregor Herburger
 */

&i2c0 {
	u-boot,dm-pre-reloc;
};

