// SPDX-License-Identifier: GPL-2.0-or-later OR MIT
/*
 * Copyright 2018 - 2021 TQ-Systems GmbH
 */

#include "fsl-imx8dxp.dtsi"
#include "tqma8xxs.dtsi"

/ {
	model = "TQ-Systems i.MX8DXP TQMa8XDPS";
	compatible = "tq,imx8dxp-tqma8xdps", "fsl,imx8dxp", "fsl,imx8qxp";
};
