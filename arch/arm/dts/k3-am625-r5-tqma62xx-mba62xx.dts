// SPDX-License-Identifier: GPL-2.0-only
/*
 * TQ-Systems TQMa62xx on MBa62xx - R5 SPL
 *
 * Copyright (C) 2021-2022 Texas Instruments Incorporated - https://www.ti.com/
 * Copyright (c) 2023 TQ-Systems GmbH <linux@ew.tq-group.com>, D-82229 Seefeld, Germany.
 * Author: Matthias Schiffer
 */

#include "k3-am625-tqma62xx-mba62xx.dts"
#include "k3-am625-tqma62xx-mba62xx-u-boot.dtsi"
#include "k3-am625-r5-tqma62xx.dtsi"

&mcu_pmx0 {
	bootph-pre-ram;

	wkup_uart0_pins: wkup-uart0-pins {
		bootph-pre-ram;

		pinctrl-single,pins = <
			AM62X_MCU_IOPAD(0x02c, PIN_INPUT, 0) /* (C6) WKUP_UART0_CTSn */
			AM62X_MCU_IOPAD(0x030, PIN_OUTPUT, 0) /* (A4) WKUP_UART0_RTSn */
			AM62X_MCU_IOPAD(0x024, PIN_INPUT, 0) /* (B4) WKUP_UART0_RXD */
			AM62X_MCU_IOPAD(0x028, PIN_OUTPUT, 0) /* (C5) WKUP_UART0_TXD */
		>;
	};
};

/* WKUP UART0 is used for DM firmware logs */
&wkup_uart0 {
	pinctrl-names = "default";
	pinctrl-0 = <&wkup_uart0_pins>;
	status = "okay";
	bootph-pre-ram;
};
