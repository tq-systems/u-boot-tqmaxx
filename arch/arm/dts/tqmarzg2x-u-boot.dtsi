// SPDX-License-Identifier: GPL-2.0-or-later OR MIT
/*
 * Copyright (c) 2023 TQ-Systems GmbH <u-boot@ew.tq-group.com>, D-82229 Seefeld, Germany.
 * Author: Paul Gerber
 *
 */

/delete-node/ &codec;

/ {
	aliases {
		/delete-property/ can0;
		/delete-property/ can1;
	};
};
