// SPDX-License-Identifier: (GPL-2.0-or-later OR MIT)
/*
 * Copyright (c) 2023 TQ-Systems GmbH <u-boot@ew.tq-group.com>,
 * D-82229 Seefeld, Germany.
 * Author: Gregor Herburger
 */

/dts-v1/;
#include "fsl-ls1043a.dtsi"
#include "fsl-ls1043a-tqmls1043a.dtsi"
#include "fsl-tqmls10xxa-mbls10xxa.dtsi"

/ {
	model = "TQMLS1043A on MBLS10xxa Board";

	aliases {
		eeprom0 = &eeprom0;
		ethernet0 = &enet0;
		ethernet1 = &enet1;
		ethernet2 = &enet2;
		ethernet3 = &enet3;
		ethernet4 = &enet4;
		ethernet5 = &enet5;
		ethernet6 = &enet6;
	};
};

#include "fsl-ls1043-post.dtsi"
#include "fsl-tqmls10xxa-mbls10xxa-fman.dtsi"
