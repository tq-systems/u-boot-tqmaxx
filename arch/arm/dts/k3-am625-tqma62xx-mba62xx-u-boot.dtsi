// SPDX-License-Identifier: GPL-2.0-only
/*
 * Copyright (C) 2021-2022 Texas Instruments Incorporated - https://www.ti.com/
 * Copyright (c) 2023-2025 TQ-Systems GmbH <u-boot@ew.tq-group.com>, D-82229 Seefeld, Germany.
 */

#include "k3-am625-tqma62xx-u-boot.dtsi"
#include "k3-am625-tqma62xx-binman.dtsi"

/ {
	chosen {
		stdout-path = "serial0:115200n8";
	};
};

&sdhci2 {
	status = "disabled";
};

&usb0 {
	/*
	 * U-Boot does not support role switching at runtime and will use
	 * peripheral mode with dr_mode = "otg". Setting it here explicitly
	 * makes that clearer, but it also allows us to override the setting
	 * to "host" for boot from USB storage; the override will fail in early
	 * boot stages otherwise, because "host" is longer than "otg".
	 */
	dr_mode = "peripheral";
};
