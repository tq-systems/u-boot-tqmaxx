## arch/arm/mach-k3/am64x/Kconfig
```kconfig
# SPDX-License-Identifier: GPL-2.0+
#
# Copyright (C) 2023 Texas Instruments Incorporated - https://www.ti.com/
#	Andrew Davis <afd@ti.com>

if SOC_K3_AM642

choice
	prompt "K3 AM64 based boards"
	optional

config TARGET_AM642_A53_EVM
	bool "TI K3 based AM642 EVM running on A53"
	select ARM64
	select BINMAN
	imply BOARD
	imply SPL_BOARD
	imply TI_I2C_BOARD_DETECT

config TARGET_AM642_R5_EVM
	bool "TI K3 based AM642 EVM running on R5"
	select CPU_V7R
	select SYS_THUMB_BUILD
	select K3_LOAD_SYSFW
	select RAM
	select SPL_RAM
	select K3_DDRSS
	select BINMAN
	imply SYS_K3_SPL_ATF
	imply TI_I2C_BOARD_DETECT

config TARGET_PHYCORE_AM64X_A53
	bool "PHYTEC phyCORE-AM64x running on A53"
	select ARM64
	select BINMAN
	imply BOARD
	imply SPL_BOARD
	imply OF_UPSTREAM

config TARGET_PHYCORE_AM64X_R5
	bool "PHYTEC phyCORE-AM64x running on R5"
	select CPU_V7R
	select SYS_THUMB_BUILD
	select K3_LOAD_SYSFW
	select RAM
	select SPL_RAM
	select K3_DDRSS
	select BINMAN
	imply SYS_K3_SPL_ATF

config TARGET_AM64_A53_TQMA64XXL
	bool "TQ-Systems TQMa64xxL running on A53"
	select ARM64
	select BOARD_LATE_INIT
	select BINMAN
	select TQ_COMMON_SYSINFO

config TARGET_AM64_R5_TQMA64XXL
	bool "TQ-Systems TQMa64xxL running on R5"
	select CPU_V7R
	select SYS_THUMB_BUILD
	select K3_LOAD_SYSFW
	select RAM
	select SPL_RAM
	select K3_DDRSS
	select PHYS_64BIT
	select SPL_BOARD_INIT
	select BINMAN
	imply SYS_K3_SPL_ATF


endchoice

source "board/phytec/phycore_am64x/Kconfig"
source "board/ti/am64x/Kconfig"
source "board/tq/tqma64xxl/Kconfig"

endif
```

## board/tq/tqma62xx/Kconfig
```kconfig
# SPDX-License-Identifier: GPL-2.0-or-later
#
# Copyright (c) 2020-2025 TQ-Systems GmbH <u-boot@ew.tq-group.com>, D-82229 Seefeld, Germany.

if TARGET_AM62_A53_TQMA62XX || TARGET_AM62_R5_TQMA62XX

config SYS_BOARD
	default "tqma62xx"

config SYS_VENDOR
	default "tq"

config SYS_CONFIG_NAME
	default "tq_k3_common"

choice
	prompt "TQ-Systems TQMa62xx base board"

config TQMA62XX_BOARD_MBA62XX
	bool "TQ-Systems MBa62xx"

endchoice

source "board/tq/common/Kconfig"

endif
```

## board/tq/tqma64xxl/Kconfig
```kconfig
# SPDX-License-Identifier: GPL-2.0-or-later
#
# Copyright (C) 2017-2018 Texas Instruments Incorporated - http://www.ti.com/
# Copyright (c) 2020-2025 TQ-Systems GmbH <u-boot@ew.tq-group.com>, D-82229 Seefeld, Germany.

if TARGET_AM64_A53_TQMA64XXL || TARGET_AM64_R5_TQMA64XXL

config SYS_BOARD
	default "tqma64xxl"

config SYS_VENDOR
	default "tq"

config SYS_CONFIG_NAME
	default "tq_k3_common"

choice
	prompt "TQ-Systems TQMa64xxL base board"

config TQMA64XXL_BOARD_MBAX4XXL
	bool "TQ-Systems MBaX4XxL"

endchoice

source "board/tq/common/Kconfig"

endif
```

## board/tq/tqma67xx/Kconfig
```kconfig
# SPDX-License-Identifier: GPL-2.0-or-later
#
# Copyright (c) 2025 TQ-Systems GmbH <u-boot@ew.tq-group.com>, D-82229 Seefeld, Germany.

if TARGET_J722S_R5_TQMA67XX || TARGET_J722S_A53_TQMA67XX

config SYS_BOARD
       default "tqma67xx"

config SYS_VENDOR
       default "tq"

config SYS_CONFIG_NAME
       default "tq_k3_common"

choice
	prompt "TQ-Systems TQMa67xx base board"

config TQMA67XX_BOARD_MBA67XX
	bool "TQ-Systems MBa67xx"

endchoice

source "board/tq/common/Kconfig"

endif
```

## board/tq/tqma6ul/Kconfig
```kconfig
# SPDX-License-Identifier: GPL-2.0-or-later
#
# Copyright (c) 2023-2024 TQ-Systems GmbH <u-boot@ew.tq-group.com>,
# D-82229 Seefeld, Germany.
# Author: Marco Felsch, Markus Niebel, Max Merchel
#

if TARGET_TQMA6UL

config SYS_BOARD
	default "tqma6ul"

config SYS_VENDOR
	default "tq"

config SYS_CONFIG_NAME
	default "tqma6ul_mba6ul" if MBA6UL
	default "tqma6ul_mba6ulxl" if MBA6ULXL

choice
	prompt "TQMa6UL module variant"
	default TQMA6UL_VARIANT_STANDARD
	help
	  Select the used TQMa6UL SoM module variant

config TQMA6UL_VARIANT_STANDARD
	bool "standard module with board connector"
	help
	  Select for SoM variant with board to board connectors

config TQMA6UL_VARIANT_LGA
	bool "LGA module with solder balls"
	help
	  Select for SoM variant LGA with solder balls

endchoice

choice
	prompt "TQMa6UL base board variant"
	default MBA6UL

config MBA6UL
	bool "TQMa6UL on MBa6ULx Starterkit"
	select TQ_BB
	select TQ_ENVLOC
	select USB
	select CMD_USB
	select USB_STORAGE
	select PHYLIB
	select PHY_SMSC
	select MXC_UART
	select DM_MMC
	select DM_SPI
	select DM_GPIO
	imply DM_SERIAL
	imply DM_ETH
	help
	  Select the MBa6ULx starterkit

config MBA6ULXL
	bool "TQMa6UL on MBa6ULxL Starterkit"
	select TQ_BB
	select TQ_ENVLOC
	select USB
	select CMD_USB
	select USB_STORAGE
	select PHYLIB
	select PHY_SMSC
	select MXC_UART
	select DM_MMC
	select DM_SPI
	select DM_GPIO
	imply DM_SERIAL
	imply DM_ETH
	help
	  Select the MBa6ULxL starterkit

endchoice

config IMX_CONFIG
	default "board/tq/tqma6ul/tqma6ul.cfg"

source "board/tq/common/Kconfig"

endif
```

## board/tq/tqma7/Kconfig
```kconfig
# SPDX-License-Identifier: GPL-2.0-or-later
#
# Copyright (c) 2016-2024 TQ-Systems GmbH <u-boot@ew.tq-group.com>,
# D-82229 Seefeld, Germany.
# Author: Markus Niebel, Steffen Doster
#

if TARGET_TQMA7

config SYS_BOARD
	default "tqma7"

config SYS_VENDOR
	default "tq"

config SYS_CONFIG_NAME
	default "tqma7"

choice
	prompt "TQMa7 boot configuration"
	default TQMA7_MMC_BOOT
	help
	  Configure boot device. This is also used to implement environment
	  location.

config TQMA7_MMC_BOOT
	bool "MMC / SD Boot"
	help
	  Boot from eMMC / SD Card

config TQMA7_QSPI_BOOT
	bool "QSPI NOR Boot"
	help
	  Boot from on board QSPI NOR flash

endchoice

choice
	prompt "TQMa7 DRAM configuration"
	default TQMA7_512MB
	help
	  Configure DRAM size

config TQMA7_512MB
	bool "512 MB DRAM"
	help
	  configure for variant with 512 MB DRAM

config TQMA7_1GB
	bool "1 GB DRAM"
	help
	  configure for variant with 1 GB DRAM

config TQMA7_2GB
	bool "2 GB DRAM"
	help
	  configure for variant with 2 GB DRAM

endchoice

choice
	prompt "TQMa7 base board variant"
	default MBA7
	help
	  Select base board for TQMa7

config MBA7
	bool "TQMa7 on MBa7x Starterkit"
	select TQ_BB
	select TQ_EEPROM
	select TQ_ENVLOC
	select USB
	select CMD_USB
	select USB_STORAGE
	select PHYLIB
	select CONFIG_PHY_TI_DP83867
	select MXC_UART
	select DM_MMC
	select DM_SPI
	select DM_GPIO
	imply DM_SERIAL
	imply DM_ETH
	help
	  Select the MBa7x starterkit.

endchoice

config IMX_CONFIG
	default "board/tq/tqma7/tqma7.cfg"

source "board/tq/common/Kconfig"

endif
```

## board/tq/tqma8mpxl/Kconfig
```kconfig
if TARGET_TQMA8MPXL

config SYS_BOARD
	default "tqma8mpxl"

config SYS_VENDOR
	default "tq"

config SYS_CONFIG_NAME
	default "tqma8mpxl"

config IMX_CONFIG
	default "board/nxp/imx8mp_evk/imximage-8mp-lpddr4.cfg"

config TQMA8MPXL_DEFAULTS
	bool
	default y
	select TQ_BB
	select TQ_COMMON_EEPROM
	select TQ_COMMON_SDMMC
	select TQ_COMMON_SPI_NOR
	select TQ_COMMON_VARD
	imply FSL_CAAM
	imply SPL_CRYPTO if SPL
	select I2C_EEPROM
	select SPL_I2C_EEPROM if SPL
	imply MISC
	imply ENV_IS_NOWHERE
	imply SYS_REDUNDAND_ENVIRONMENT
	imply ENV_OVERWRITE
	imply OF_UPSTREAM

choice
	prompt "TQMa8MPxL RAM configuration"
	default TQMA8MPXL_RAM_MULTI
	help
	  Select RAM configuration. Normally use default here but for
	  specific setup it is possible to use a single RAM size.

config TQMA8MPXL_RAM_MULTI
	bool "TQMa8MPxL with 1/2/4/8 GB RAM - Single image"
	select TQMA8MPXL_RAM_1024MB
	select TQMA8MPXL_RAM_2048MB
	select TQMA8MPXL_RAM_4096MB
	select TQMA8MPXL_RAM_8192MB
	select BLOBLIST
	select SPL_BLOBLIST
	help
	  Build a single U-Boot for variants with 1/2/4/8 GB RAM. Select whether to use
	  the inline ECC capability or not using config item IMX8M_DRAM_INLINE_ECC

config TQMA8MPXL_RAM_SINGLE_2GB
	bool "TQMa8MPxL with 2 GB RAM"
	select TQMA8MPXL_RAM_2048MB
	help
	  Build U-Boot for variants with 2 GB RAM.  Select whether to use
	  the inline ECC capability or not using config item IMX8M_DRAM_INLINE_ECC

endchoice

config TQMA8MPXL_RAM_1024MB
	bool

config TQMA8MPXL_RAM_2048MB
	bool

config TQMA8MPXL_RAM_4096MB
	bool

config TQMA8MPXL_RAM_8192MB
	bool

choice
	prompt "TQMa8MPxL base board variant"
	default TQMA8MPXL_BB_MBA8MPXL
	help
	  Select base board for TQMa8MPxL

config TQMA8MPXL_BB_MBA8MPXL
	bool "TQMa8MPxL on MBa8MPxL Starterkit"
	select GPIO_HOG
	help
	  Select the MBa8MPxL starterkit for TQMa8MPxL board.
	  This features most interfaces the CPU can provide.

endchoice

source "board/tq/common/Kconfig"

endif
```

## board/tq/tqma8mpxs/Kconfig
```kconfig
if TARGET_TQMA8MPXS

config SYS_BOARD
	default "tqma8mpxs"

config SYS_VENDOR
	default "tq"

config SYS_CONFIG_NAME
	default "tqma8mpxs"

config IMX_CONFIG
	default "board/freescale/imx8mp_evk/imximage-8mp-lpddr4.cfg"

config TQMA8MPXS_DEFAULTS
	bool
	default y
	select TQ_BB
	select TQ_EEPROM
	select TQ_RTC
	select TQ_SDMMC
	select TQ_SPI_NOR
	select TQ_VARD
	imply FSL_CAAM
	imply SPL_CRYPTO if SPL
	select I2C_EEPROM
	select SPL_I2C_EEPROM if SPL
	imply MISC
	imply ENV_IS_NOWHERE
	imply SYS_REDUNDAND_ENVIRONMENT
	imply ENV_OVERWRITE

choice
	prompt "TQMa8MPxS RAM configuration"
	default TQMA8MPXS_RAM_MULTI
	help
	  Select RAM configuration. Normally use default here but for
	  specific setup it is possible to use a single RAM size.

config TQMA8MPXS_RAM_MULTI
	bool "TQMa8MPxS with 1/2/4/8 GB RAM - Single image"
	select TQMA8MPXS_RAM_1024MB
	select TQMA8MPXS_RAM_2048MB
	select TQMA8MPXS_RAM_4096MB
	select TQMA8MPXS_RAM_8192MB
	help
	  Build a single U-Boot for variants with 1/2/4/8 GB RAM. Select whether to use
	  the inline ECC capability or not using config item IMX8M_DRAM_INLINE_ECC

#
# When compiling for a single product using only one SoM variant, an alternate config
# supporting only a single RAM configuration may be added.
#

endchoice

config TQMA8MPXS_RAM_1024MB
	bool

config TQMA8MPXS_RAM_2048MB
	bool

config TQMA8MPXS_RAM_4096MB
	bool

config TQMA8MPXS_RAM_8192MB
	bool

choice
	prompt "TQMa8MPxS base board variant"
	default TQMA8MPXS_BB_MB_SMARC_2
	help
	  Select base board for TQMa8MPxS

config TQMA8MPXS_BB_MB_SMARC_2
	bool "TQMa8MPxS on MB_SMARC_2 Board"
	help
	  Select the MB_SMARC_2 board for TQMa8MPxS board.
	  This features most interfaces the CPU can provide.

endchoice

source "board/tq/common/Kconfig"

endif
```

## board/tq/tqma93xx/Kconfig
```kconfig
if TARGET_TQMA91XX || TARGET_TQMA93XX

config SYS_BOARD
	default "tqma93xx"

config SYS_VENDOR
	default "tq"

config SYS_CONFIG_NAME
	default "tqma93xx"

config TQMA93XX_DEFAULTS
	bool
	select IMX9_LPDDR4X
	select TQ_BB
	select TQ_EEPROM
	select TQ_RTC
	select TQ_SDMMC
	select TQ_VARD
	imply MISC
	imply I2C_EEPROM

choice
	prompt "TQMa91xx/TQMa93xx mainboard variant"
	default TQMA93XX_BB_MBA93XXCA
	help
	  Select mainboard variant for the SOM. Default is the MBa93xxCA
	  starterkit.

config TQMA93XX_BB_MBA91XXCA
	bool "MBa91xxCA starterkit"
	select DM_GPIO
	select ENV_IS_NOWHERE
	select TQMA93XX_DEFAULTS
	select USB_TCPC if USB
	help
	  Select the MBa91xxCA starterkit. The evaluation board can
	  demonstrate most of the features of the SOM and CPU and can be
	  used for LGA and connector SOM variants

config TQMA93XX_BB_MBA93XXCA
	bool "MBa93xxCA starterkit"
	select DM_GPIO
	select ENV_IS_NOWHERE
	select TQMA93XX_DEFAULTS
	select USB_TCPC if USB
	help
	  Select the MBa93xxCA starterkit. The evaluation board can
	  demonstrate most of the features of the SOM and CPU and can be
	  used for LGA and connector SOM variants

config TQMA93XX_BB_MBA93XXLA
	bool "MBa93xxLA SBC"
	select DM_GPIO
	select ENV_IS_NOWHERE
	select TQMA93XX_DEFAULTS
	select USB_TCPC if USB
	help
	  Select the MBa93xxLA SBC. This mainboard has the LGA SOM
	  variant assembled.

config TQMA93XX_BB_MBA93XXLA_MINI
	bool "MBa93xxLA-MINI SBC"
	select DM_GPIO
	select ENV_IS_NOWHERE
	select TQMA93XX_DEFAULTS
	help
	  Select the MBa93xxLA-MINI SBC. This mainboard has the LGA SOM
	  variant assembled.

endchoice

choice
	prompt "TQMa91/93 RAM configuration"
	default TQMA93XX_RAM_MULTI
	help
	  Select RAM configuration. Normally use default here but for
	  specific setup it is possible to use a single RAM size.

config TQMA93XX_RAM_MULTI
	bool "TQMa91/93 with multiple DRAM configs - Single image"
	select TQMA93XX_RAM_1024MB
	select TQMA93XX_RAM_1536MB if TARGET_TQMA93XX
	select TQMA93XX_RAM_2048MB if TARGET_TQMA93XX
	help
	  Build a single U-Boot image usable for all RAM variants.
	  The RAM size and variant to be used is derived from TQ_VARD
	  data in EEPROM. Inline ECC can be selected with config item
	  IMX9_DRAM_INLINE_ECC.

config TQMA93XX_RAM_SINGLE_1GB
	bool "TQMa91/93 with 1 GB RAM"
	select TQMA93XX_RAM_1024MB
	help
	  Build a U-Boot image usable for 1GB RAM variants.
	  This can be used as a base for configurations with
	  a fixed feature set can not depend on VARD for security
	  reasons.  Inline ECC can be selected with config item
	  IMX9_DRAM_INLINE_ECC.

endchoice

config TQMA93XX_RAM_1024MB
	bool

config TQMA93XX_RAM_1536MB
	bool

config TQMA93XX_RAM_2048MB
	bool

source "board/tq/common/Kconfig"

endif
```

## board/tq/tqma95xxla/Kconfig
```kconfig
if TARGET_TQMA95XXLA

config SYS_BOARD
	default "tqma95xxla"

config SYS_VENDOR
	default "tq"

config SYS_CONFIG_NAME
	default "tqma95xxla"

config TQMA95XXLA_DEFAULTS
	bool
	select IMX95
	select TQ_BB
	select TQ_EEPROM
	select TQ_RTC
	select TQ_SDMMC
	select TQ_VARD
	imply MISC
	imply I2C_EEPROM

choice
	prompt "TQMa95xxLA mainboard variant"
	default TQMA95XXLA_BB_MBA95XXCA
	help
	  Select mainboard variant for the SOM. Default is the
	  starterkit.

config TQMA95XXLA_BB_MBA95XXCA
	bool "MBa95xxCA starter kit and mainboard"
	select DM_GPIO
	select ENV_IS_NOWHERE
	select TQMA95XXLA_DEFAULTS
	help
	  Select the MBa95xxCA. This mainboard is intended as starter kit for
	  solderable TQMa95xxLA SOM on adaptor.

endchoice

choice
	prompt "TQMa95xxLA RAM Configuration"
	default TQMA95XXLA_RAM_2GB_DEFAULT
	help
	  Select RAM Configuration. Depending on Board usage and assembled RAM
	  base address and usable RAM size have to be adjusted.

config TQMA95XXLA_RAM_2GB_DEFAULT
	bool "2 GiB default configuration"
	help
	  2GiB RAM assembled. The first 256 MiB are reserved.
	  In this reserved region the shared memory for Cortex-M7
	  is located.

config TQMA95XXLA_RAM_4GB_DEFAULT
	bool "4 GiB default configuration"
	help
	  4GiB RAM assembled. The first 256 MiB are reserved.
	  In this reserved region the shared memory for Cortex-M7
	  is located.

endchoice

config MTDPARTS_DEFAULT
	default "mtdparts=425e0000.spi:4m@0k(bootstream),64k@4096k(env0),64k@4160k(env1),-@6m(ubi)"

config MTDIDS_DEFAULT
	default "nor0=425e0000.spi"

source "board/tq/common/Kconfig"

endif
```
