## board/tqc/tqma8mx/Kconfig
```kconfig
if TARGET_TQMA8MX

config SYS_BOARD
	default "tqma8mx"

config SYS_VENDOR
	default "tqc"

config SYS_CONFIG_NAME
	default "tqma8mx"

config SPL_TEXT_BASE
	default "0x7E1000"

config CSF_SIZE
	default "0x2000"

config TQMA8MX_DEFAULTS
	bool
	default y
	select TQC_SDMMC
	select TQC_EEPROM
	select TQC_RTC
	select BOARD_LATE_INIT
	select BOARD_EARLY_INIT_F
	select OF_CONTROL
	select OF_BOARD_SETUP
	select OF_SYSTEM_SETUP
	select PINCTRL
	select PINCTRL_IMX8M
	select DM
	select DM_MMC
	select FSL_USDHC
	select MMC_IO_VOLTAGE
	select MMC_UHS_SUPPORT
	select MMC_HS400_ES_SUPPORT
	select MMC_HS400_SUPPORT
	select DM_THERMAL
	select DM_GPIO
	select MXC_GPIO
	select DM_I2C
	select SYS_I2C_MXC
	select DM_REGULATOR
	select DM_REGULATOR_FIXED
	select MISC
	select FSL_QSPI
	select DM_SPI
	select SPI
	select DM_SPI_FLASH
	select MTD
	select SPI_FLASH_MTD
	select SPI_FLASH
	select SPI_FLASH_MACRONIX
	select SPI_FLASH_SPANSION
	select SPI_FLASH_STMICRO
	select SPI_FLASH_SST
	select SPI_FLASH_WINBOND
	select SPI_FLASH_ATMEL
	select SPI_FLASH_EON
	select SPI_FLASH_GIGADEVICE
	select SPI_FLASH_ISSI
	select FIT
	select SPL
	select SPL_ENV_SUPPORT
	select SPL_GPIO_SUPPORT
	select SPL_DRIVERS_MISC_SUPPORT
	select SPL_LIBCOMMON_SUPPORT
	select SPL_LIBGENERIC_SUPPORT
	select SPL_I2C_SUPPORT
	select SPL_POWER_SUPPORT
	select SPL_BOARD_INIT
	select SPL_LOAD_FIT
	select SPL_SEPARATE_BSS

config TQMA8MX_MFG_SUPPORT
	bool "MFG Tool support for TQMa8Mx"
	select USB
	select DM_USB
	select USB_GADGET
	select DM_USB_GADGET
	select USB_GADGET_DUALSPEED
	select USB_XHCI_HCD
	select USB_XHCI_IMX8M
	select USB_XHCI_DWC3
	select USB_DWC3
	select USB_DWC3_GADGET
	select USB_FUNCTION_SDP
	select USB_FUNCTION_FASTBOOT
	select FASTBOOT_UUU_SUPPORT
	select FASTBOOT_FLASH
	select CMD_FASTBOOT
	select SPL_USB_GADGET
	select SPL_USB_SDP_SUPPORT

if TQMA8MX_MFG_SUPPORT

config USB_GADGET_MANUFACTURER
	default "FSL"

config USB_GADGET_VENDOR_NUM
	default 0x0525

config USB_GADGET_PRODUCT_NUM
	default 0xa4a5

config USB_GADGET_VBUS_DRAW
	default 2

config SDP_LOADADDR
	default 0x40400000

config FASTBOOT_BUF_ADDR
	default 0x42800000

# restrict to 512M
config FASTBOOT_BUF_SIZE
	default 0x20000000

config FASTBOOT_USB_DEV
	default 0 if TQMA8MX_BB_MBA8MX

endif

config NR_DRAM_BANKS
	default 3

config SYS_TEXT_BASE
	default 0x40200000

config IMX_CONFIG
	default "arch/arm/mach-imx/imx8m/imximage.cfg"

config SYS_MALLOC_F_LEN
	default 0x2000

config SAVED_DRAM_TIMING_BASE
	default 0x40000000

config SPL_FIT_GENERATOR
	default "arch/arm/mach-imx/mkimage_fit_atf.sh"

config FIT_EXTERNAL_OFFSET
	default "0x3000"

choice
	prompt "TQMa8MX Memory variant"
	default TQMA8MX_RAM_2G
	help
	  Select memory variant for TQMa8MX

config TQMA8MX_RAM_4G
	bool "TQMa8MX with 4GB LPDDR4"
	help
	  Select module with 4GB LPDDR4"

config TQMA8MX_RAM_2G
	bool "TQMa8MX with 2GB LPDDR4"
	help
	  Select module with 2GB LPDDR4"

config TQMA8MX_RAM_1G
	bool "TQMa8MX with 1GB LPDDR4"
	help
	  Select module with 1GB LPDDR4"

endchoice

choice
	prompt "TQMa8MX base board variant"
	default TQMA8MX_BB_MBA8MX
	help
	  Select base board for TQMa8MX

####
# TODO: DM_SERIAL is not usable, since UART clock not under DM managed clocks
# but common/board_f initializes early DM stuff before board code can enable
# UART clk.
####

config TQMA8MX_BB_MBA8MX
	bool "TQMa8MX on MBa8MX Starterkit"
	select TQC_ENVLOC
	select SYS_REDUNDAND_ENVIRONMENT
	select ENV_OVERWRITE
	select MXC_UART
	select SPL_SERIAL_SUPPORT
	select CMD_FUSE
	select DM_ETH
	select FEC_MXC
	select MII
	select DM_ETH_PHY
	select PHY_GIGE
	select PHYLIB
	select PHY_GIGE
	select PHY_TI
	select USB
	select DM_USB
	select USB_XHCI_HCD
	select USB_XHCI_IMX8M
	select USB_XHCI_DWC3
	select USB_DWC3
	select CMD_MII
	select CMD_PING
	select CMD_DHCP
	select CMD_NET
	help
	  Select the MBa8Mx starterkit. This features a GigE Phy, USB, SD-Card
	  etc.

endchoice

config DEFAULT_DEVICE_TREE
	default "imx8mq-mba8mx" if TQMA8MX_BB_MBA8MX

config DEFAULT_FDT_FILE
	default "imx8mq-tqma8mq-mba8mx.dtb" if TQMA8MX_BB_MBA8MX


menu "TQMa8Mx boot device"

config TQMBA8MX_BOOT_SDCARD
	bool "TQMa8Mx from SD / e-MMC"
	default "y"
	select SD_BOOT
	select ENV_IS_IN_MMC
	select SPL_MMC_SUPPORT
	select SUPPORT_EMMC_BOOT
	help
	  Select booting from SD / e-MMC. This selects MMC based env, SPL
	  support for MMC/SD and support for e-MMC boot partitions.
	  Additionally you should supply env offsets via devicetree config
	  node

endmenu

#
# default values for QSPI NOR. Will be used also for environment from QSPI
# if ENV_SPI_[BUS,CS,MODE,SPEED] are not used to overwrite.
#

config SF_DEFAULT_BUS
	default 0

config SF_DEFAULT_CS
	default 0

config SF_DEFAULT_SPEED
	default 40000000

config SF_DEFAULT_MODE
	default 0

#
# environment settings: 32k, offset 4M (SPI NOR sector 64k), redundant env
# in SPI NOR @ 4M + 64k
#
config ENV_SIZE
	default 0x00008000

config ENV_SECT_SIZE
	default 0x00010000

config ENV_OFFSET
	default 0x00400000

config ENV_OFFSET_REDUND
	default 0x00410000

source "board/tqc/common/Kconfig"

endif
```

## board/tqc/tqma8mxml/Kconfig
```kconfig
if TARGET_TQMA8MXML || TARGET_TQMA8MXNL

config SYS_BOARD
	default "tqma8mxml"

config SYS_VENDOR
	default "tqc"

config SYS_CONFIG_NAME
	default "tqma8mxml"

# Attention: i.MX8MM has different settings for SPL_TEXT_BASE depending on boot
# device

config SPL_TEXT_BASE
	default "0x912000" if IMX8MN
	default "0x7E1000" if IMX8MM && TQMA8MXX_BOOT_SDCARD
	default "0x7E2000" if IMX8MM && TQMA8MXX_BOOT_FSPI

#
# even if this is the Kconfig default in the memory controller Kconfig for
# i.MX8M, we set this here for completeness. This value is hard coded in the
# TF-A port (imx-atf) for i.MXMM / i.MXNN
#
config SAVED_DRAM_TIMING_BASE
	default 0x180000 if IMX8MM
	default 0x180000 if IMX8MN

config FIT_EXTERNAL_OFFSET
	default 0x3000

config SPL_FIT_GENERATOR
	default "arch/arm/mach-imx/mkimage_fit_atf.sh"

config TQMA8MXX_DEFAULTS
	bool
	default y
	select CLK_COMPOSITE_CCF
	select CLK_IMX8MM if IMX8MM
	select CLK_IMX8MN if IMX8MN
	select TQC_SDMMC
	select TQC_EEPROM
	select TQC_RTC
	select BOARD_LATE_INIT
	select BOARD_EARLY_INIT_F
	select FIT
	select OF_CONTROL
	select OF_BOARD_SETUP
	select OF_SYSTEM_SETUP
	select PINCTRL
	select PINCTRL_IMX8M
	select DM
	select DM_MMC
	select FSL_USDHC
	select MMC_IO_VOLTAGE
	select MMC_UHS_SUPPORT
	select MMC_HS400_ES_SUPPORT
	select MMC_HS400_SUPPORT
	select DM_THERMAL
	select DM_GPIO
	select MXC_GPIO
	select DM_I2C
	select SYS_I2C_MXC
	select SYS_I2C_MXC_I2C1
	select SYS_I2C_MXC_I2C2
	select SYS_I2C_MXC_I2C3
	select MISC
	select FSL_FSPI
	select DM_SPI
	select SPI
	select DM_SPI_FLASH
	select MTD
	select SPI_FLASH_MTD
	select SPI_FLASH
	select SPI_FLASH_MACRONIX
	select SPI_FLASH_SPANSION
	select SPI_FLASH_STMICRO
	select SPI_FLASH_SST
	select SPI_FLASH_WINBOND
	select SPI_FLASH_ATMEL
	select SPI_FLASH_EON
	select SPI_FLASH_GIGADEVICE
	select SPI_FLASH_ISSI
	select SPL
	select SPL_LOAD_FIT
	select SPL_BOARD_INIT
	select SPL_ENV_SUPPORT
	select SPL_GPIO_SUPPORT
	select SPL_DRIVERS_MISC_SUPPORT
	select SPL_POWER_SUPPORT
	select SPL_I2C_SUPPORT
	select SPL_LIBGENERIC_SUPPORT
	select SPL_LIBCOMMON_SUPPORT

config TQMA8MXX_MFG_SUPPORT
	bool "MFG Tool support"
	select USB_GADGET
	select DM_USB_GADGET
	select CI_UDC
	select USB_FUNCTION_SDP
	select USB_FUNCTION_FASTBOOT
	select FASTBOOT_UUU_SUPPORT
	select FASTBOOT_FLASH
	select CMD_FASTBOOT
	select SPL_USB_GADGET
	select SPL_USB_SDP_SUPPORT
	select SPL_USB_HOST_SUPPORT
	select SPL_IMX_ROMAPI_SUPPORT if MX8MN

if TQMA8MXX_MFG_SUPPORT

config USB_GADGET_MANUFACTURER
	default "FSL"

config USB_GADGET_VENDOR_NUM
	default 0x0525

config USB_GADGET_PRODUCT_NUM
	default 0xa4a5

config USB_GADGET_VBUS_DRAW
	default 2

config SDP_LOADADDR
	default 0x40400000

config FASTBOOT_BUF_ADDR
	default 0x42800000

# restrict to 256M
config FASTBOOT_BUF_SIZE
	default 0x10000000

config FASTBOOT_USB_DEV
	default 0 if TQMA8MXX_BB_MBA8MX

endif

config SPL_IMX_ROMAPI_LOADADDR
	default 0x48000000 if TARGET_TQMA8MXNL

config NR_DRAM_BANKS
	default 1

config SYS_TEXT_BASE
	default 0x40200000

config SYS_MALLOC_F_LEN
	default 0x2000

#
# TODO: delete?
#
config IMX_CONFIG
	default "arch/arm/mach-imx/imx8m/imximage-8mm-lpddr4.cfg" if IMX8MM && TQMA8MXX_BOOT_SDCARD
	default "arch/arm/mach-imx/imx8m/imximage-8mm-lpddr4-fspi.cfg" if IMX8MM && TQMA8MXX_BOOT_FSPI
	default "arch/arm/mach-imx/imx8m/imximage-8mn-lpddr4.cfg" if IMX8MN

choice
	prompt "TQMa8MMX RAM size"
	default TQMA8MMX_RAM_1024MB if IMX8MN
	default TQMA8MMX_RAM_2048MB if IMX8MM
	help
	  Select RAM size for TQMa8MMx

config TQMA8MMX_RAM_1024MB
	bool "TQMa8MMx with 1024 MiB RAM"
	help
	  Select variant with 1024 MiB RAM

config TQMA8MMX_RAM_2048MB
	bool "TQMa8MMx with 2048 MiB RAM"
	help
	  Select variant with 2048 MiB RAM

endchoice

choice
	prompt "TQMa8MXX base board variant"
	default TQMA8MXX_BB_MBA8MX
	help
	  Select base board for TQMa8MxML/TQMa8MxNL

####
# TODO: DM_SERIAL is not usable, since UART clock not under DM managed clocks
# but common/board_f initializes early DM stuff before board code can enable
# UART clk.
####

config TQMA8MXX_BB_MBA8MX
	bool "TQMa8MxML/TQMa8MxNL on MBa8Mx Starterkit"
	select TQC_ENVLOC if !IMX8MN
	select ENV_IS_NOWHERE
	select MXC_UART
	select MII
	select DM_ETH
	select DM_ETH_PHY
	select FEC_MXC
	select PHYLIB
	select PHY_GIGE
	select PHY_TI
	select USB
	select DM_USB
	select MXC_USB_OTG_HACTIVE
	select USB_EHCI_HCD
	select SPL_SERIAL_SUPPORT
	select DM_PCA953X
	select CMD_FUSE
	select CMD_MII
	select CMD_PING
	select CMD_DHCP
	select CMD_NET
	select SYS_REDUNDAND_ENVIRONMENT
	select ENV_OVERWRITE
	help
	  Select the MBa8Mx starterkit. This features a GigE Phy, USB, SD-Card
	  etc.

endchoice

config DEFAULT_DEVICE_TREE
	default "imx8mn-mba8mx" if TQMA8MXX_BB_MBA8MX && IMX8MN
	default "imx8mm-mba8mx" if TQMA8MXX_BB_MBA8MX && IMX8MM

config DEFAULT_FDT_FILE
	default "imx8mn-tqma8mqnl-mba8mx.dtb" if TQMA8MXX_BB_MBA8MX && IMX8MN
	default "imx8mm-tqma8mqml-mba8mx.dtb" if TQMA8MXX_BB_MBA8MX && IMX8MM

menu "TQMa8MXX boot device"

config TQMA8MXX_BOOT_SDCARD
	bool "TQMa8MxML/TQMa8MxNL boot from SD / e-MMC"
	default "y" if IMX8MN
	select SD_BOOT
	select ENV_IS_IN_MMC
	select SPL_MMC_SUPPORT
	select SUPPORT_EMMC_BOOT
	help
	  Select booting from SD / e-MMC. This selects MMC based env, SPL
	  support for MMC/SD and support for e-MMC boot partitions.
	  Additionally you should supply env offsets via devicetree config
	  node

#
# For booting from FlexSPI it is not needed to setup the FlexSPI controller
# again. SPL_SPI_<xyz> configs do not need to be selected. Image is loaded using
# SPL_NOR_SUPPORT. For this to work CONFIG_SYS_UBOOT_BASE must point to
# AHB Address Base + Offset of the fit image (ATF, U-Boot, etc.) in SPI NOR
# SPL_NOR_SUPPORT uses reading from FlexSPI AHB adress space the LUT config for
# AHB setup from boot ROM
#
config TQMA8MXX_BOOT_FSPI
	bool "TQMa8MxML/TQMa8MxNL boot from FlexSPI"
	default "y" if IMX8MN
	select QSPI_BOOT
	select ENV_IS_IN_SPI_FLASH
	select SPL_NOR_SUPPORT
	help
	  Select booting from FlexSPI

endmenu

#
# default values for FLEXSPI NOR. Will be used also for environment from FLEXSPI
# if ENV_SPI_[BUS,CS,MODE,SPEED] are not used to overwrite.
#

config SF_DEFAULT_BUS
	default 0

config SF_DEFAULT_CS
	default 0

config SF_DEFAULT_SPEED
	default 40000000

config SF_DEFAULT_MODE
	default 0

#
# environment settings: 32k, offset 4M (SPI NOR sector 64k), redundant env
# in SPI NOR @ 4M + 64k
#
config ENV_SIZE
	default 0x00008000

config ENV_SECT_SIZE
	default 0x00010000

config ENV_OFFSET
	default 0x00400000

config ENV_OFFSET_REDUND
	default 0x00410000

source "board/tqc/common/Kconfig"

endif
```

## board/tqc/tqma8qx/Kconfig
```kconfig
if TARGET_TQMA8QX

config SYS_BOARD
	default "tqma8qx"

config SYS_VENDOR
	default "tqc"

config SYS_CONFIG_NAME
	default "tqma8qx"

choice
	prompt "TQMa8QX CPU variant"
	default TQMA8QX_MX8QXP
	help
	  Select cpu variant for TQMa8QX

config TQMA8QX_MX8QXP
	bool "TQMa8QX with i.MX8QXP"
	help
	  Select the CPU variant

endchoice

choice
	prompt "TQMa8QX base board variant"
	default MBA8QX
	help
	  Select base board for TQMa8QX

config MBA8QX
	bool "TQMa8QX on MBa8QX Starterkit"
	select TQC_SDMMC
	select DM_ETH
	help
	  Select the MBa8QX starterkit. This features a GigE Phy, USB, SD-Card
	  etc.

endchoice

choice
	prompt "TQMa8QX boot device"
	default TQMBA8QX_SDCARD
	help
	  Select boot device for TQMa8QX

config TQMBA8QX_SDCARD
	bool "TQMa8QX from SD / e-MMC"
	select SD_BOOT
	help
	  Select booting from SD / e-MMC

endchoice


source "board/tqc/common/Kconfig"

endif
```

## board/tqc/tqma8qxs/Kconfig
```kconfig
if TARGET_TQMA8QXS

config SYS_BOARD
	default "tqma8qxs"

config SYS_VENDOR
	default "tqc"

config SYS_CONFIG_NAME
	default "tqma8qxs"

choice
	prompt "TQMa8QXS CPU variant"
	default TQMA8QXS_CPU_MX8QXP
	help
	  Select cpu variant for TQMa8QXS

config TQMA8QXS_CPU_MX8QXP
	bool "TQMa8XQPS with i.MX8QXP"
	help
	  Select the CPU variant

config TQMA8QXS_CPU_MX8DX
	bool "TQMa8XDS with i.MX8DX"
	help
	  Select the CPU variant

endchoice

choice
	prompt "TQMa8XxS RAM size"
	default TQMA8QXS_RAM_1014MB if TQMA8QX_CPU_MX8QXP
	default TQMA8QXS_RAM_512MB if TQMA8QXS_CPU_MX8DX
	help
	  Select RAM size for TQMa8XxS

config TQMA8QXS_RAM_512MB
	bool "TQMa8XxS with 512 MiB RAM"
	help
	  Select variant with 512 MiB RAM

config TQMA8QXS_RAM_1014MB
	bool "TQMa8XxS with 1024 MiB RAM"
	help
	  Select variant with 1024 MiB RAM

config TQMA8QXS_RAM_2048MB
	bool "TQMa8XxS with 2048 MiB RAM"
	help
	  Select variant with 2048 MiB RAM

endchoice

choice
	prompt "TQMa8QXS base board variant"
	default TQMA8QXS_MB_SMARC_2
	help
	  Select base board for TQMa8QXS

config TQMA8QXS_MB_SMARC_2
	bool "TQMa8QXS on MB_SMARC_2 Board"
	select TQC_SDMMC
	help
	  Select the MB_SMARC_2 board. This is a SMARC2 mainboard
	  etc.

endchoice

config DEFAULT_DEVICE_TREE
	default "fsl-imx8dx-tqma8dxs-mb-smarc-2" if TQMA8QXS_CPU_MX8DX && TQMA8QXS_MB_SMARC_2
	default "fsl-imx8qxp-tqma8qxps-mb-smarc-2" if TQMA8QXS_CPU_MX8QXP && TQMA8QXS_MB_SMARC_2

config DEFAULT_FDT_FILE
	default "fsl-imx8dx-tqma8dxs-mb-smarc-2.dtb" if TQMA8QXS_CPU_MX8DX && TQMA8QXS_MB_SMARC_2
	default "fsl-imx8qxp-tqma8qxps-mb-smarc-2.dtb" if TQMA8QXS_CPU_MX8QXP && TQMA8QXS_MB_SMARC_2

choice
	prompt "TQMa8QXS boot device"
	default TQMA8QXS_BOOT_SDCARD
	help
	  Select boot device for TQMa8QXS

config TQMA8QXS_BOOT_SDCARD
	bool "TQMa8QXS from SD / e-MMC"
	select SD_BOOT
	select ENV_IS_IN_MMC
	help
	  Select booting from SD / e-MMC

endchoice


source "board/tqc/common/Kconfig"

endif
```
