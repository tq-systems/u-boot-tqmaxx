## board/tqc/tqma65xx/Kconfig
```kconfig
# SPDX-License-Identifier: GPL-2.0-or-later
#
# Copyright (C) 2017-2018 Texas Instruments Incorporated - http://www.ti.com/
# Copyright (C) 2020-2022 TQ-Systems GmbH

choice
	prompt "TQ-Systems TQMa65xx"
	optional

config TARGET_AM654_A53_TQMA65XX
	bool "TQ-Systems TQMa65xx running on A53"
	select ARM64
	select SOC_K3_AM6
	select SYS_DISABLE_DCACHE_OPS
	select BOARD_LATE_INIT
	select TQ_BOARD_GPIO
	select TQ_EEPROM

config TARGET_AM654_R5_TQMA65XX
	bool "TQ-Systems TQMa65xx running on R5"
	select CPU_V7R
	select SYS_THUMB_BUILD
	select SOC_K3_AM6
	select K3_LOAD_SYSFW
	select K3_AM654_DDRSS
	imply SYS_K3_SPL_ATF

endchoice

if TARGET_AM654_A53_TQMA65XX || TARGET_AM654_R5_TQMA65XX

config SYS_BOARD
	default "tqma65xx"

config SYS_VENDOR
	default "tqc"

choice
	prompt "TQ-Systems TQMa65xx module variant"

config TQMA65XX_MODULE_VERSION_2G
	bool "TQMa65xx 2GB variant"

config TQMA65XX_MODULE_VERSION_4G
	bool "TQMa65xx 4GB variant"

endchoice

choice
	prompt "TQ-Systems TQMa65xx base board"

config TQMA65XX_BOARD_MBA65XX
	bool "TQ-Systems MBa65xx"

endchoice

config SYS_CONFIG_NAME
	default "tqma65xx_mba65xx" if TQMA65XX_BOARD_MBA65XX

source "board/tqc/common/Kconfig"

endif

if TARGET_AM654_R5_TQMA65XX

config SPL_LDSCRIPT
	default "arch/arm/mach-omap2/u-boot-spl.lds"

endif
```

## board/tqc/tqma6ul/Kconfig
```kconfig
if TARGET_TQMA6UL

config SYS_BOARD
	default "tqma6ul"

config SYS_VENDOR
	default "tqc"

config SYS_SOC
	default "mx6"

config SYS_CONFIG_NAME
	default "tqma6ul"

config TQMA6UL_COMMON
	bool
	select SPI_FLASH if MBA6UL || TQMA6UL_QSPI_BOOT
	select SPI_FLASH if MBA6ULXL || TQMA6UL_QSPI_BOOT
	select SPI_FLASH_STMICRO if SPI_FLASH
	select SPI_FLASH_WINBOND if SPI_FLASH
	select SPI_FLASH_SPANSION if SPI_FLASH
	select SPI_FLASH_MTD if SPI_FLASH
	select SPI_FLASH_BAR if SPI_FLASH

choice
	prompt "TQMa6UL CPU variant"
	default TQMA6UL
	help
	  Configure module variant.

config TQMA6UL
	bool
	prompt "TQMa6ULx with i.MX6UL"
	select MX6UL
	select TQMA6UL_COMMON
	help
	  select TQMa6UL with i.MX6UL and 256 MiB DRAM

config TQMA6ULL
	bool
	prompt "TQMa6ULLx with i.MX6ULL"
	select MX6ULL
	select TQMA6UL_COMMON
	help
	  select TQMa6ULL with i.MX6ULL and 256 MiB DRAM

endchoice

choice
	prompt "TQMa6UL module variant"
	default TQMA6UL_VARIANT_STANDARD
	help
	  Configure module variant.

config TQMA6UL_VARIANT_STANDARD
	bool "standard module with board connector"
	help
	  "TQMa6ULx variant with board to board connectors"

config TQMA6UL_VARIANT_LGA
	bool "LGA module with solder balls"
	help
	  "TQMa6ULxL variant LGA with solder balls"

endchoice

choice
	prompt "TQMa6UL boot configuration"
	default TQMA6UL_MMC_BOOT
	help
	  Configure boot device. This is also used to implement environment
	  location.

config TQMA6UL_MMC_BOOT
	bool "MMC / SD Boot"
	select SD_BOOT
	help
	  Boot from eMMC / SD Card

config TQMA6UL_QSPI_BOOT
	bool "QSPI NOR Boot"
	select SPI_FLASH
	select QSPI_BOOT
	help
	  Boot from on board QSPI NOR flash

endchoice


choice
	prompt "TQMa6UL DRAM configuration"
	default TQMA6UL_256MB
	help
	  Configure DRAM size

config TQMA6UL_256MB
	bool "256 MB DRAM"
	help
	  configure for variant with 256 MB DRAM

config TQMA6UL_512MB
	bool "512 MB DRAM"
	help
	  configure for variant with 512 MB DRAM

endchoice

choice
	prompt "TQMa6UL base board variant"
	default MBA6UL

config MBA6UL
	bool "TQMa6UL on MBa6UL Starterkit"
	help
	  Select the MBa6ULx starterkit.

config MBA6ULXL
	bool "TQMa6ULxL on MBa6ULxL base board"
	depends on TQMA6UL_VARIANT_LGA
	help
	  Select the MBa6ULxL Kit.

endchoice

config IMX_CONFIG
	default "board/tqc/tqma6ul/tqma6ul.cfg" if TQMA6UL && TQMA6UL_256MB
	default "board/tqc/tqma6ul/tqma6ull.cfg" if TQMA6ULL && TQMA6UL_256MB
	default "board/tqc/tqma6ul/tqma6ul_512mb.cfg" if TQMA6UL && TQMA6UL_512MB
	default "board/tqc/tqma6ul/tqma6ull_512mb.cfg" if TQMA6ULL && TQMA6UL_512MB

source "board/tqc/common/Kconfig"

endif
```

## board/tqc/tqma7/Kconfig
```kconfig
if TARGET_TQMA7

config SYS_BOARD
	default "tqma7"

config SYS_VENDOR
	default "tqc"

config SYS_SOC
	default "mx7"

config SYS_CONFIG_NAME
	default "tqma7"

config TQMA7
	bool
	select MX7D
	select SPI_FLASH if MBA7 || TQMA7_QSPI_BOOT
	select SPI_FLASH_STMICRO if SPI_FLASH
	select SPI_FLASH_WINBOND if SPI_FLASH
	select SPI_FLASH_SPANSION if SPI_FLASH
	select SPI_FLASH_MTD if SPI_FLASH
	select SPI_FLASH_BAR if SPI_FLASH

choice
	prompt "TQMa7 boot configuration"
	default TQMA7_MMC_BOOT
	help
	  Configure boot device. This is also used to implement environment
	  location.

config TQMA7_MMC_BOOT
	bool "MMC / SD Boot"
	select SD_BOOT
	help
	  Boot from eMMC / SD Card

config TQMA7_QSPI_BOOT
	bool "QSPI NOR Boot"
	select QSPI_BOOT
	help
	  Boot from on board QSPI NOR flash

endchoice


choice
	prompt "TQMa7 DRAM configuration"
	default TQMA7_512MB
	help
	  Configure DRAM size

config TQMA7_512MB
	bool "512 MB DRAM"
	help
	  configure for variant with 512 MB DRAM

config TQMA7_1GB
	bool "1 GB DRAM"
	help
	  configure for variant with 1 GB DRAM

config TQMA7_2GB
	bool "2 GB DRAM"
	help
	  configure for variant with 2 GB DRAM

endchoice


choice
	prompt "TQMa7 base board variant"
	default MBA7

config MBA7
	bool "TQMa7 on MBa7 Starterkit"
	help
	  Select the MBa7 starterkit.

endchoice

config IMX_CONFIG
	default "board/tqc/tqma7/tqma7d.cfg"

source "board/tqc/common/Kconfig"

endif
```

## board/tqc/tqma8mmx/Kconfig
```kconfig
if TARGET_TQMA8MNX || TARGET_TQMA8MMX

config SYS_BOARD
	default "tqma8mmx"

config SYS_VENDOR
	default "tqc"

config SYS_CONFIG_NAME
	default "tqma8mmx"

choice
	prompt "TQMa8MMX RAM size"
	default TQMA8MMX_RAM_1024MB if IMX8MN
	default TQMA8MMX_RAM_1024MB if IMX8MM
	help
	  Select RAM size for TQMa8MMx

config TQMA8MMX_RAM_1024MB
	bool "TQMa8MMx with 1024 MiB RAM"
	help
	  Select variant with 1024 MiB RAM

config TQMA8MMX_RAM_2048MB
	bool "TQMa8MMx with 2048 MiB RAM"
	help
	  Select variant with 2048 MiB RAM

endchoice

choice
	prompt "TQMa8MXX base board variant"
	default TQMA8MXX_BB_MBA8MX
	help
	  Select base board for TQMa8MMx/TQMa8MNx

config TQMA8MXX_BB_MBA8MX
	bool "TQMa8MMx/TQMa8MNx on MBa8Mx Starterkit"
	select TQC_SDMMC
	select CMD_FUSE
	select MII
	select CMD_MII
	select CMD_PING
	select CMD_DHCP
	select CMD_NET
	select DM_ETH
	select FEC_MXC
	select PHYLIB
	select PHY_GIGE
	select PHY_TI
	help
	  Select the MBa8Mx starterkit. This features a GigE Phy, USB, SD-Card
	  etc.

endchoice

config DEFAULT_DEVICE_TREE
	default "fsl-imx8mn-mba8mx" if TQMA8MXX_BB_MBA8MX && IMX8MN
	default "fsl-imx8mm-mba8mx" if TQMA8MXX_BB_MBA8MX && IMX8MM

config DEFAULT_FDT_FILE
	default "imx8mn-mba8mx.dtb" if TQMA8MXX_BB_MBA8MX && IMX8MN
	default "imx8mm-mba8mx.dtb" if TQMA8MXX_BB_MBA8MX && IMX8MM

config NR_DRAM_BANKS
	default 1 

config SYS_TEXT_BASE
	default 0x40200000 

config SYS_MALLOC_F_LEN
	default 0x2000 

config SAVED_DRAM_TIMING_BASE
	default 0x40000000 

config FIT_EXTERNAL_OFFSET
	default 0x3000 

config SPL_FIT_GENERATOR
	default "arch/arm/mach-imx/mkimage_fit_atf.sh" 

config SYS_EXTRA_OPTIONS
	default "IMX_CONFIG=arch/arm/mach-imx/imx8m/imximage.cfg,SPL_TEXT_BASE=0x7E1000" if TARGET_TQMA8MMX
	default "IMX_CONFIG=arch/arm/mach-imx/imx8m/imximage.cfg,SPL_TEXT_BASE=0x912000" if TARGET_TQMA8MNX

menu "TQMa8MXX boot device"

config TQMA8MXX_BOOT_SDCARD
	bool "TQMa8MMx/TQMa8MNx boot from SD / e-MMC"
	default "y"
	select SD_BOOT
	select ENV_IS_IN_MMC
	help
	  Select booting from SD / e-MMC

config TQMA8MXX_BOOT_FSPI
	bool "TQMa8MMx/TQMa8MNx boot from FlexSPI"
	select QSPI_BOOT
	select ENV_IS_IN_SPI_FLASH
	help
	  Select booting from FlexSPI

endmenu

config TQMA8MXX_DEFAULTS
	bool
	default y
	select ARCH_MISC_INIT
	select TQC_EEPROM
	select TQC_RTC
	select BOARD_LATE_INIT
	select BOARD_EARLY_INIT_F
	select FIT
	select OF_CONTROL
	select OF_BOARD_SETUP
	select OF_SYSTEM_SETUP
	select PINCTRL
	select PINCTRL_IMX8M
	select DM
	select DM_MMC
	select MMC_IO_VOLTAGE
	select MMC_HS400_SUPPORT
	select FSL_ESDHC
	select DM_THERMAL
	select DM_SERIAL
	select MXC_UART
	select DM_GPIO
	select MXC_GPIO
	select DM_I2C
	select SYS_I2C_MXC
	select MISC
	select FSL_FSPI
	select DM_SPI
	select SPI
	select DM_SPI
	select SPI_FLASH_MTD
	select DM_SPI_FLASH
	select SPI_FLASH
	select SPI_FLASH_4BYTES_ADDR
	select SPI_FLASH_MACRONIX
	select SPI_FLASH_SPANSION
	select SPI_FLASH_STMICRO
	select SPI_FLASH_SST
	select SPI_FLASH_WINBOND
	select SPL
	select SPL_LOAD_FIT
	select SPL_BOARD_INIT
	select SPL_ENV_SUPPORT
	select SPL_SERIAL_SUPPORT
	select SPL_GPIO_SUPPORT
	select SPL_MMC_SUPPORT
	select SPL_DRIVERS_MISC_SUPPORT
	select SPL_POWER_SUPPORT
	select SPL_I2C_SUPPORT
	select SPL_LIBGENERIC_SUPPORT
	select SPL_LIBCOMMON_SUPPORT
	select SPL_SPI_FLASH_SUPPORT
	select SPL_SPI_FLASH_TINY
	select SPL_SPI_SUPPORT

config SF_DEFAULT_BUS
	default 0

config SF_DEFAULT_CS
	default 0

config SF_DEFAULT_SPEED
	default 40000000

config SF_DEFAULT_MODE
	default 0

config TQMA8MXX_MFG_SUPPORT
	bool "MFG Tool support"
	select USB
	select DM_USB
	select USB_GADGET
	select DM_USB_GADGET
	select CI_UDC
	select USB_EHCI_HCD
	select MXC_USB_OTG_HACTIVE
	select USB_FUNCTION_SDP
	select USB_FUNCTION_FASTBOOT
	select FASTBOOT_UUU_SUPPORT
	select FASTBOOT_FLASH
	select CMD_FASTBOOT
	select SPL_USB_HOST_SUPPORT
	select SPL_USB_GADGET
	select SPL_USB_SDP_SUPPORT
	select SPL_IMX_ROMAPI_SUPPORT if TARGET_TQMA8MNX

if TQMA8MXX_MFG_SUPPORT

config USB_GADGET_MANUFACTURER
	default "FSL"

config USB_GADGET_VENDOR_NUM
	default 0x0525

config USB_GADGET_PRODUCT_NUM
	default 0xa4a5

config USB_GADGET_VBUS_DRAW
	default 2

config SDP_LOADADDR
	default 0x40400000

config FASTBOOT_BUF_ADDR
	default 0x42800000

config SPL_IMX_ROMAPI_LOADADDR
	default 0x48000000 if TARGET_TQMA8MNX

# restrict to 256M
config FASTBOOT_BUF_SIZE
	default 0x10000000

config FASTBOOT_USB_DEV
	default 0 if TQMA8MXX_BB_MBA8MX

endif

source "board/tqc/common/Kconfig"

endif
```

## board/tqc/tqma8mpxl/Kconfig
```kconfig
if TARGET_TQMA8MPXL

config SYS_BOARD
	default "tqma8mpxl"

config SYS_VENDOR
	default "tqc"

config SYS_CONFIG_NAME
	default "tqma8mpxl"

config SPL_TEXT_BASE
	default "0x920000"

config CSF_SIZE
	default "0x2000"

config TQMA8MPXL_DEFAULTS
	bool
	default y
	select TQC_SDMMC
	select TQC_EEPROM
	select TQC_RTC
	select BOARD_LATE_INIT
	select BOARD_EARLY_INIT_F
	select OF_CONTROL
	select OF_BOARD_SETUP
	select OF_SYSTEM_SETUP
	select PINCTRL
	select REGMAP
	select SYSCON
	select CLK_COMPOSITE_CCF
	select CLK_IMX8MP
	select PINCTRL_IMX8M
	select DM
	select DM_MMC
	select FSL_USDHC
	select MMC_IO_VOLTAGE
	select MMC_UHS_SUPPORT
	select MMC_HS400_ES_SUPPORT
	select MMC_HS400_SUPPORT
	select DM_THERMAL
	select DM_GPIO
	select MXC_GPIO
	select DM_I2C
	select SYS_I2C_MXC
	select SYS_I2C_MXC_I2C1
	select DM_REGULATOR
	select DM_REGULATOR_FIXED
	select MISC
	select FSL_FSPI
	select DM_SPI
	select SPI
	select DM_SPI_FLASH
	select MTD
	select SPI_FLASH_MTD
	select SPI_FLASH
	select SPI_FLASH_MACRONIX
	select SPI_FLASH_SPANSION
	select SPI_FLASH_STMICRO
	select SPI_FLASH_SST
	select SPI_FLASH_WINBOND
	select SPI_FLASH_EON
	select SPI_FLASH_GIGADEVICE
	select SPI_FLASH_ISSI
	select FIT
	select SPL
	select SPL_GPIO_SUPPORT
	select SPL_DRIVERS_MISC_SUPPORT
	select SPL_LIBCOMMON_SUPPORT
	select SPL_LIBGENERIC_SUPPORT
	select SPL_I2C_SUPPORT
	select SPL_POWER_SUPPORT
	select SPL_BOARD_INIT
	select SPL_LOAD_FIT
	select SPL_BOOTROM_SUPPORT
	select SPL_SEPARATE_BSS

config TQMA8MPXL_MFG_SUPPORT
	bool "MFG Tool support"
	select USB_GADGET
	select USB_GADGET_DOWNLOAD
	select CONFIG_USB_DWC3
	select USB_FUNCTION_SDP
	select USB_FUNCTION_FASTBOOT
	select FASTBOOT_UUU_SUPPORT
	select FASTBOOT_FLASH
	select CMD_FASTBOOT
	select SPL_USB_GADGET
	select SPL_USB_SDP_SUPPORT
	select SPL_USB_HOST_SUPPORT
	select SPL_IMX_ROMAPI_SUPPORT if MX8MN

if TQMA8MPXL_MFG_SUPPORT

config USB_GADGET_MANUFACTURER
	default "FSL"

config USB_GADGET_VENDOR_NUM
	default 0x0525

config USB_GADGET_PRODUCT_NUM
	default 0xa4a5

config USB_GADGET_VBUS_DRAW
	default 2

config SDP_LOADADDR
	default 0x40400000

config FASTBOOT_BUF_ADDR
	default 0x42800000

# restrict to 256M
config FASTBOOT_BUF_SIZE
	default 0x10000000

config FASTBOOT_USB_DEV
	default 0 if TQMA8MPXL_BB_MBA8MPXL || TQMA8MPXL_BB_SBC

endif

choice
	prompt "TQMa8MPXL RAM configuration"
	default TQMA8MPXL_RAM_2048MB
	help
	  Select RAM configuration for TQMa8MPXL

config TQMA8MPXL_RAM_2048MB_1G5
	bool "TQMa8x with 2048 MiB RAM, 1.5 GHz, no ECC"
	help
	  Select variant with 2048 MiB RAM / 1.5 GHz and no ECC

config TQMA8MPXL_RAM_2048MB
	bool "TQMa8x with 2048 MiB RAM, no ECC"
	help
	  Select variant with 2048 MiB RAM

config TQMA8MPXL_RAM_8192MB
	bool "TQMa8x with 8192 MiB RAM, no ECC"
	help
	  Select variant with 8192 MiB RAM

config TQMA8MPXL_RAM_2048MB_ECC
	bool "TQMa8x with 2048 MiB RAM, with ECC"
	select IMX8M_DRAM_INLINE_ECC
	help
	  Select variant with 2048 MiB RAM and inline ECC

endchoice

config NR_DRAM_BANKS
	default 3

config SYS_TEXT_BASE
	default 0x40200000

config IMX_CONFIG
	default "arch/arm/mach-imx/imx8m/imximage-8mp-lpddr4.cfg"

config SPL_FIT_GENERATOR
	default "arch/arm/mach-imx/mkimage_fit_atf.sh"

config FIT_EXTERNAL_OFFSET
	default "0x3000"

config SPL_IMX_ROMAPI_LOADADDR
	default "0x48000000"

choice
	prompt "TQMa8MPxL base board variant"
	default TQMA8MPXL_BB_MBA8MPXL
	help
	  Select base board for TQMa8MPxL

config TQMA8MPXL_BB_MBA8MPXL
	bool "TQMa8MPxL on MBa8MPxL Starterkit"
	select ENV_IS_NOWHERE
	select SYS_REDUNDAND_ENVIRONMENT
	select ENV_OVERWRITE
	select MXC_UART
	select DM_SERIAL
	select SPL_SERIAL_SUPPORT
	select CMD_FUSE
	select DM_ETH
	select DWC_ETH_QOS
	select FEC_MXC
	select MII
	select DM_ETH_PHY
	select PHY_GIGE
	select PHYLIB
	select PHY_GIGE
	select PHY_TI
	select USB
	select DM_USB
	select USB_XHCI_HCD
	select USB_XHCI_IMX8M
	select USB_XHCI_DWC3
	select USB_DWC3
	select CMD_MII
	select CMD_PING
	select CMD_DHCP
	select CMD_NET
	help
	  Select the MBa8MPxL starterkit for TQMa8MPxL board.
	  This features most interfaces the CPU can provide

endchoice

config DEFAULT_DEVICE_TREE
	default "imx8mp-mba8mpxl" if TQMA8MPXL_BB_MBA8MPXL

config DEFAULT_FDT_FILE
	default "imx8mp-tqma8mpql-mba8mpxl.dtb" if TQMA8MPXL_BB_MBA8MPXL

menu "TQMa8MPxL boot device"

config TQMA8MPXL_BOOT_SDCARD
	bool "TQMa8MPxL boot from SD / e-MMC"
	default "y"
	select SD_BOOT
	select ENV_IS_IN_MMC
	select SPL_MMC_SUPPORT
	select SUPPORT_EMMC_BOOT
	help
	  Select booting from SD / e-MMC. This selects MMC based env, SPL
	  support for MMC/SD and support for e-MMC boot partitions.
	  Additionally you should supply env offsets via devicetree config
	  node

config TQMBA8MPXL_BOOT_FSPI
	bool "TQMa8MPxL boot from FlexSPI"
	default "y"
	select QSPI_BOOT
	select ENV_IS_IN_SPI_FLASH
	select SPL_NOR_SUPPORT
	help
	  Select booting from QSPI NOR at FlexSPI port

endmenu

#
# default values for FLEXSPI NOR. Will be used also for environment from FLEXSPI
# if ENV_SPI_[BUS,CS,MODE,SPEED] are not used to overwrite.
#

config SF_DEFAULT_BUS
	default 0

config SF_DEFAULT_CS
	default 0

config SF_DEFAULT_SPEED
	default 40000000

config SF_DEFAULT_MODE
	default 0

#
# environment settings: 32k, offset 4M (SPI NOR sector 64k), redundant env
# in SPI NOR @ 4M + 64k
#
config ENV_SIZE
	default 0x00008000

config ENV_SECT_SIZE
	default 0x00010000

config ENV_OFFSET
	default 0x00400000

config ENV_OFFSET_REDUND
	default 0x00410000

source "board/tqc/common/Kconfig"

endif
```
