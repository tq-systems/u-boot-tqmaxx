## board/tqc/tqma8xxs/Kconfig
```kconfig
if TARGET_TQMA8XXS

config SYS_BOARD
	default "tqma8xxs"

config SYS_VENDOR
	default "tqc"

config SYS_CONFIG_NAME
	default "tqma8xxs"

config SPL_TEXT_BASE
	default "0x100000"

#
# allows building flash.bin without imx-mkimage
#
config IMX_CONTAINER_CFG
	default "board/tqc/tqma8xx/uboot-container.cfg"

config TQMA8XXS_DEFAULTS
	bool
	default y if TARGET_TQMA8XXS
	select SMC_FUSE
	select CLK_IMX8
	select TQC_SDMMC
	select TQC_EEPROM
	select TQC_SCU
	select TQC_RTC
	select TQC_ENVLOC
	select TQC_SPI_NOR
	select BOARD_LATE_INIT
	select BOARD_EARLY_INIT_F
	select FIT
	select OF_CONTROL
	select OF_BOARD_SETUP
	select OF_SYSTEM_SETUP
	select PINCTRL
	select PINCTRL_IMX8
	select POWER_DOMAIN
	select IMX8_POWER_DOMAIN
	select DM
	select DM_MMC
	select FSL_USDHC
	select MMC_IO_VOLTAGE
	select MMC_UHS_SUPPORT
	select MMC_HS400_ES_SUPPORT
	select MMC_HS400_SUPPORT
	select DM_THERMAL
	select DM_SERIAL
	select FSL_LPUART
	select DM_GPIO
	select MXC_GPIO
	select DM_I2C
	select SYS_I2C_IMX_LPI2C
	select DM_REGULATOR
	select DM_REGULATOR_FIXED
	select MISC
	select MII
	select DM_ETH
	select DM_ETH_PHY
	select FEC_MXC
	select PHYLIB
	select PHY_GIGE
	select PHY_TI
	select NXP_FSPI
	select DM_SPI
	select SPI
	select DM_SPI_FLASH
	select MTD
	select SPI_FLASH_MTD
	select SPI_FLASH
	select SPI_FLASH_MACRONIX
	select SPI_FLASH_SPANSION
	select SPI_FLASH_STMICRO
	select SPI_FLASH_SST
	select SPI_FLASH_WINBOND
	select SPI_FLASH_EON
	select SPI_FLASH_GIGADEVICE
	select SPI_FLASH_ISSI
	select USB
	select DM_USB
	select USB_EHCI_HCD
	select USB_EHCI_MX6
	select MXC_USB_OTG_HACTIVE
	select USB_XHCI_HCD
	select USB_XHCI_IMX8
	select USB_GADGET
	select USB_CDNS3_GADGET
	select USB_CDNS3
	select PHY
	select CDNS3_USB_PHY
	select SPL
	select SPL_DM
	select SPL_OF_CONTROL
	select SPL_LOAD_IMX_CONTAINER
	select SPL_BOARD_INIT
	select SPL_CLK
	select SPL_ENV_SUPPORT
	select SPL_SERIAL_SUPPORT
	select SPL_GPIO_SUPPORT
	select SPL_MMC_SUPPORT
	select SPL_DRIVERS_MISC_SUPPORT
	select SPL_POWER_SUPPORT
	select SPL_POWER_DOMAIN
	select SPL_I2C_SUPPORT
	select SPL_DM_REGULATOR
	select SPL_DM_REGULATOR_FIXED
	select SPL_LIBGENERIC_SUPPORT
	select SPL_LIBCOMMON_SUPPORT
	select SPL_SPI_FLASH_SUPPORT
	select SPL_SPI_FLASH_TINY
	select SPL_SPI_SUPPORT
	select SPL_SPI_LOAD
	select SPL_DM_SEQ_ALIAS
	select SYS_REDUNDAND_ENVIRONMENT
	select ENV_OVERWRITE

config TQMA8XXS_MFG_SUPPORT
	bool "MFG Tool support"
	select USB
	select DM_USB
	select USB_GADGET
	select DM_USB_GADGET
	select CI_UDC
	select USB_PORT_AUTO
	select USB_XHCI_HCD
	select USB_XHCI_IMX8
	select USB_GADGET
	select USB_CDNS3_GADGET
	select USB_FUNCTION_SDP
	select USB_FUNCTION_FASTBOOT
	select FASTBOOT_UUU_SUPPORT
	select FASTBOOT_FLASH
	select CMD_FASTBOOT
	select SPL_USB_GADGET
	select SPL_USB_SDP_SUPPORT
	select SPL_DM_USB
	select SPL_DM_USB_GADGET
	select SPL_USB_HOST_SUPPORT
	select SPL_PHY
	select SPL_ENV_SUPPORT
	select SPL_ENV_IS_NOWHERE

if TQMA8XXS_MFG_SUPPORT

config USB_GADGET_MANUFACTURER
	default "FSL"

config USB_GADGET_VENDOR_NUM
	default 0x0525

config USB_GADGET_PRODUCT_NUM
	default 0xa4a5

config USB_GADGET_VBUS_DRAW
	default 2

config SDP_LOADADDR
	default 0x80400000

config FASTBOOT_BUF_ADDR
	default 0x82800000

# restrict to 512M
config FASTBOOT_BUF_SIZE
	default 0x40000000

endif

choice
	prompt "TQMa8XxS CPU variant"
	default TQMA8XXS_CPU_MX8QXP
	help
	  Select cpu variant for TQMa8QXS

config TQMA8XXS_CPU_MX8QXP
	bool "TQMa8XxS with i.MX8QXP"
	help
	  Select the CPU variant i.MX8QXP

config TQMA8XXS_CPU_MX8DXP
	bool "TQMa8XxS with i.MX8DXP"
	help
	  Select the CPU variant i.MX8DXP

endchoice

config NR_DRAM_BANKS
	default 4

config SYS_TEXT_BASE
	default 0x80020000

config SYS_MALLOC_F_LEN
	default 0x8000

config IMX_CONFIG
	default "board/tqc/tqma8xxs/imximage.cfg"

choice
	prompt "TQMa8XxS RAM size"
	default TQMA8XXS_RAM_2048MB if TQMA8XXS_CPU_MX8QXP
	default TQMA8XXS_RAM_2048MB if TQMA8XXS_CPU_MX8DXP
	help
	  Select RAM size for TQMa8XxS

config TQMA8XXS_RAM_1024MB
	bool "TQMa8XxS with 1024 MiB RAM"
	help
	  Select variant with 1024 MiB RAM

config TQMA8XXS_RAM_2048MB
	bool "TQMa8XxS with 2048 MiB RAM"
	help
	  Select variant with 2048 MiB RAM

endchoice

choice
	prompt "TQMa8XxS base board variant"
	default TQMA8XXS_BB_MB_SMARC_2
	help
	  Select base board for TQMa8XxS

config TQMA8XXS_BB_MB_SMARC_2
	bool "TQMa8XxS on MB_SMARC_2 Board"
	select TQC_ENVLOC
	select CMD_FUSE
	select CMD_MII
	select CMD_PING
	select CMD_DHCP
	select CMD_NET
	help
	  Select the MB-SMARC-2 board. This is a SMARC2 mainboard

endchoice

config DEFAULT_DEVICE_TREE
	default "imx8qxp-mb-smarc-2" if TQMA8XXS_CPU_MX8QXP && TQMA8XXS_BB_MB_SMARC_2
	default "imx8dxp-mb-smarc-2" if TQMA8XXS_CPU_MX8DXP && TQMA8XXS_BB_MB_SMARC_2

config DEFAULT_FDT_FILE
	default "imx8qxp-tqma8xqps-mb-smarc-2.dtb" if TQMA8XXS_CPU_MX8QXP && TQMA8XXS_BB_MB_SMARC_2
	default "imx8dxp-tqma8xdps-mb-smarc-2.dtb" if TQMA8XXS_CPU_MX8DXP && TQMA8XXS_BB_MB_SMARC_2

menu "TQMa8XxS boot device"

config TQMA8XXS_BOOT_SDCARD
	bool "TQMa8XxS boot from SD / e-MMC"
	default "y"
	select SD_BOOT
	select ENV_IS_IN_MMC
	select SPL_MMC_SUPPORT
	select SUPPORT_EMMC_BOOT
	help
	  Select booting from SD / e-MMC. This selects MMC based env, SPL
	  support for MMC/SD and support for e-MMC boot partitions.
	  Additionally you should supply env offsets via devicetree config
	  node

config TQMA8XXS_BOOT_FSPI
	bool "TQMa8XxS boot from FlexSPI"
	default "y"
	select QSPI_BOOT
	select ENV_IS_IN_SPI_FLASH
	help
	  Select booting from QSPI NOR at FlexSPI port

endmenu

#
# default values for FLEXSPI NOR. Will be used also for environment from FLEXSPI
# if ENV_SPI_[BUS,CS,MODE,SPEED] are not used to overwrite.
#

config SF_DEFAULT_BUS
	default 0

config SF_DEFAULT_CS
	default 0

config SF_DEFAULT_SPEED
	default 40000000

config SF_DEFAULT_MODE
	default 0

config SYS_SPI_U_BOOT_OFFS
	default 0x200000


config MTDPARTS_DEFAULT
	default "mtdparts=nor0:4m@0k(bootstream),64k@4096k(env0),64k@4160k(env1),58m@4224k(ubi)"

config MTDIDS_DEFAULT
	default "nor0=nor0"

#
# environment settings: 32k, offset 4M (SPI NOR sector 64k), redundant env
# in SPI NOR @ 4M + 64k
#
config ENV_SIZE
	default 0x00008000

config ENV_SECT_SIZE
	default 0x00010000

config ENV_OFFSET
	default 0x00400000

config ENV_OFFSET_REDUND
	default 0x00410000

source "board/tqc/common/Kconfig"

endif
```
