## board/tqc/tqma8x/Kconfig
```kconfig
if TARGET_TQMA8X

config SYS_BOARD
	default "tqma8x"

config SYS_VENDOR
	default "tqc"

config SYS_CONFIG_NAME
	default "tqma8x"

config SPL_TEXT_BASE
	default "0x100000"

#
# allows building flash.bin without imx-mkimage
#
#config IMX_CONTAINER_CFG
#	default "board/tqc/tqma8x/uboot-container.cfg"

config TQMA8X_DEFAULTS
	bool
	default y if TARGET_TQMA8X
	select SMC_FUSE
	select CLK_IMX8
	select TQC_SDMMC
	select TQC_EEPROM
	select TQC_SCU
	select TQC_RTC
	select BOARD_LATE_INIT
	select BOARD_EARLY_INIT_F
	select IMX_SMMU
	select FIT
	select OF_CONTROL
	select OF_BOARD_SETUP
	select OF_SYSTEM_SETUP
	select PINCTRL
	select PINCTRL_IMX8
	select POWER_DOMAIN
	select IMX8_POWER_DOMAIN
	select DM
	select DM_MMC
	select FSL_USDHC
	select MMC_IO_VOLTAGE
	select MMC_UHS_SUPPORT
	select MMC_HS400_ES_SUPPORT
	select MMC_HS400_SUPPORT
	select DM_THERMAL
	select DM_GPIO
	select MXC_GPIO
	select DM_I2C
	select SYS_I2C_IMX_LPI2C
	select DM_REGULATOR
	select DM_REGULATOR_FIXED
	select MISC
	select FSL_FSPI
	select DM_SPI
	select SPI
	select DM_SPI_FLASH
	select MTD
	select SPI_FLASH_MTD
	select SPI_FLASH
	select SPI_FLASH_MACRONIX
	select SPI_FLASH_SPANSION
	select SPI_FLASH_STMICRO
	select SPI_FLASH_SST
	select SPI_FLASH_WINBOND
	select SPL
	select SPL_DM
	select SPL_OF_CONTROL
	select SPL_LOAD_IMX_CONTAINER
	select SPL_BOARD_INIT
	select SPL_CLK
	select SPL_GPIO_SUPPORT
	select SPL_MMC_SUPPORT
	select SPL_DRIVERS_MISC_SUPPORT
	select SPL_POWER_SUPPORT
	select SPL_POWER_DOMAIN
	select SPL_DM_REGULATOR
	select SPL_DM_REGULATOR_FIXED
	select SPL_LIBGENERIC_SUPPORT
	select SPL_LIBCOMMON_SUPPORT
	select SPL_SPI_FLASH_SUPPORT
	select SPL_SPI_FLASH_TINY
	select SPL_SPI_SUPPORT
	select SPL_SPI_LOAD
	select SPL_DM_SEQ_ALIAS
	select SYS_REDUNDAND_ENVIRONMENT
	select ENV_OVERWRITE

choice
	prompt "TQMa8x CPU variant"
	default TQMA8X_CPU_MX8QM
	help
	  Select cpu variant for TQMa8x

config TQMA8X_CPU_MX8QM
	bool "TQMa8x with i.MX8QM"
	help
	  Select CPU i.MX8QM

endchoice

config NR_DRAM_BANKS
	default 4

config SYS_TEXT_BASE
	default 0x80020000

config SYS_MALLOC_F_LEN
	default 0x8000

config IMX_CONFIG
	default "board/tqc/tqma8x/imximage.cfg"

choice
	prompt "TQMa8x RAM size"
	default TQMA8X_RAM_4096MB if TQMA8X_CPU_MX8QM
	help
	  Select RAM size for TQMa8x

config TQMA8X_RAM_4096MB
	bool "TQMa8x with 4096 MiB RAM"
	help
	  Select variant with 4096 MiB RAM

config TQMA8X_RAM_8192MB
	bool "TQMa8x with 8192 MiB RAM"
	help
	  Select variant with 8192 MiB RAM

endchoice

choice
	prompt "TQMa8x base board variant"
	default TQMA8X_BB_MBA8X
	help
	  Select base board for TQMa8x

config TQMA8X_BB_MBA8X
	bool "TQMa8x on MBa8x Starterkit"
	select TQC_ENVLOC
	select DM_SERIAL
	select FSL_LPUART
	select MII
	select DM_ETH
	select DM_ETH_PHY
	select FEC_MXC
	select PHYLIB
	select PHY_GIGE
	select PHY_TI
	select USB
	select DM_USB
	select PHY
	select USB_EHCI_HCD
	select USB_EHCI_MX6
	select MXC_USB_OTG_HACTIVE
	select USB_XHCI_HCD
	select USB_XHCI_IMX8
	select USB_CDNS3
	select USB_GADGET
	select USB_CDNS3_GADGET
	select CDNS3_USB_PHY
	select SPL_SERIAL_SUPPORT
	select DM_PCA953X
	select CMD_FUSE
	select CMD_MII
	select CMD_PING
	select CMD_DHCP
	select CMD_NET
	help
	  Select the MBa8x starterkit. This features a GigE Phy, USB, SD-Card
	  etc.

endchoice

config DEFAULT_DEVICE_TREE
	default "imx8qm-mba8x" if TQMA8X_CPU_MX8QM && TQMA8X_BB_MBA8X

config DEFAULT_FDT_FILE
	default "imx8qm-mba8x.dtb" if TQMA8X_CPU_MX8QM && TQMA8X_BB_MBA8X

menu "TQMa8x boot device"

config TQMA8X_BOOT_SDCARD
	bool "TQMa8x boot from SD / e-MMC"
	default "y"
	select SD_BOOT
	select ENV_IS_IN_MMC
	help
	  Select booting from SD / e-MMC, you should supply env offsets per
	  devicetree

config TQMBA8X_BOOT_FSPI
	bool "TQMa8X boot from FlexSPI"
	default "y"
	select QSPI_BOOT
	select ENV_IS_IN_SPI_FLASH
	help
	  Select booting from QSPI NOR at FlexSPI port

endmenu

#
# default values for FLEXSPI NOR. Will be used also for environment from FLEXSPI
# if ENV_SPI_[BUS,CS,MODE,SPEED] are not used to overwrite.
#

config SF_DEFAULT_BUS
	default 0

config SF_DEFAULT_CS
	default 0

config SF_DEFAULT_SPEED
	default 40000000

config SF_DEFAULT_MODE
	default 0

config SYS_SPI_U_BOOT_OFFS
	default 0x200000

#
# environment settings: 32k, offset 4M (SPI NOR sector 64k), redundant env
# in SPI NOR @ 4M + 64k
#
# These should go here, when updating U-Boot to newer Version
#
config ENV_SIZE
	default 0x00008000

config ENV_SECT_SIZE
	default 0x00010000

config ENV_OFFSET
	default 0x00400000

config ENV_OFFSET_REDUND
	default 0x00410000

source "board/tqc/common/Kconfig"

endif
```

## board/tqc/tqma8xx/Kconfig
```kconfig
if TARGET_TQMA8XX

config SYS_BOARD
	default "tqma8xx"

config SYS_VENDOR
	default "tqc"

config SYS_CONFIG_NAME
	default "tqma8xx"

config SPL_TEXT_BASE
	default "0x100000"

#
# allows building flash.bin without imx-mkimage
#
config IMX_CONTAINER_CFG
	default "board/tqc/tqma8xx/uboot-container.cfg"

config TQMA8XX_DEFAULTS
	bool
	default y if TARGET_TQMA8XX
	select SMC_FUSE
	select CLK_IMX8
	select TQC_SDMMC
	select TQC_EEPROM
	select TQC_SCU
	select TQC_RTC
	select BOARD_LATE_INIT
	select FIT
	select OF_CONTROL
	select OF_BOARD_SETUP
	select OF_SYSTEM_SETUP
	select PINCTRL
	select PINCTRL_IMX8
	select POWER_DOMAIN
	select IMX8_POWER_DOMAIN
	select DM
	select DM_MMC
	select FSL_USDHC
	select MMC_IO_VOLTAGE
	select MMC_UHS_SUPPORT
	select MMC_HS400_ES_SUPPORT
	select MMC_HS400_SUPPORT
	select DM_THERMAL
	select DM_GPIO
	select MXC_GPIO
	select DM_I2C
	select SYS_I2C_IMX_LPI2C
	select DM_REGULATOR
	select DM_REGULATOR_FIXED
	select MISC
	select FSL_FSPI
	select DM_SPI
	select SPI
	select DM_SPI_FLASH
	select MTD
	select SPI_FLASH_MTD
	select SPI_FLASH
	select SPI_FLASH_MACRONIX
	select SPI_FLASH_SPANSION
	select SPI_FLASH_STMICRO
	select SPI_FLASH_SST
	select SPI_FLASH_WINBOND
	select SPL
	select SPL_DM
	select SPL_OF_CONTROL
	select SPL_LOAD_IMX_CONTAINER
	select SPL_BOARD_INIT
	select SPL_CLK
	select SPL_GPIO_SUPPORT
	select SPL_MMC_SUPPORT
	select SPL_DRIVERS_MISC_SUPPORT
	select SPL_POWER_SUPPORT
	select SPL_POWER_DOMAIN
	select SPL_DM_REGULATOR
	select SPL_DM_REGULATOR_FIXED
	select SPL_LIBGENERIC_SUPPORT
	select SPL_LIBCOMMON_SUPPORT
	select SPL_SPI_FLASH_SUPPORT
	select SPL_SPI_FLASH_TINY
	select SPL_SPI_SUPPORT
	select SPL_SPI_LOAD
	select SPL_DM_SEQ_ALIAS
	select SYS_REDUNDAND_ENVIRONMENT
	select ENV_OVERWRITE

config TQMA8XX_MFG_SUPPORT
	bool "MFG Tool support"
	select USB_GADGET
	select DM_USB_GADGET
	select CI_UDC
	select USB_PORT_AUTO
	select USB_FUNCTION_SDP
	select USB_FUNCTION_FASTBOOT
	select FASTBOOT_UUU_SUPPORT
	select FASTBOOT_FLASH
	select CMD_FASTBOOT
	select SPL_USB_GADGET
	select SPL_USB_SDP_SUPPORT
	select SPL_DM_USB_GADGET
	select SPL_USB_HOST_SUPPORT
	select SPL_PHY
	select SPL_ENV_SUPPORT
	select SPL_ENV_IS_NOWHERE

if TQMA8XX_MFG_SUPPORT

config USB_GADGET_MANUFACTURER
	default "FSL"

config USB_GADGET_VENDOR_NUM
	default 0x0525

config USB_GADGET_PRODUCT_NUM
	default 0xa4a5

config USB_GADGET_VBUS_DRAW
	default 2

config SDP_LOADADDR
	default 0x80400000

config FASTBOOT_BUF_ADDR
	default 0x82800000

# restrict to 512M
config FASTBOOT_BUF_SIZE
	default 0x40000000

endif

choice
	prompt "TQMa8Xx CPU variant"
	default TQMA8XX_CPU_MX8QXP
	help
	  Select cpu variant for TQMa8Xx

config TQMA8XX_CPU_MX8QXP
	bool "TQMa8Xx with i.MX8QXP"
	help
	  Select the CPU variant i.MX8QXP

config TQMA8XX_CPU_MX8DXP
	bool "TQMa8Xx with i.MX8DXP"
	help
	  Select the CPU variant i.MX8DXP

endchoice

config NR_DRAM_BANKS
	default 4

config SYS_TEXT_BASE
	default 0x80020000

config SYS_MALLOC_F_LEN
	default 0x8000

config IMX_CONFIG
	default "board/tqc/tqma8xx/imximage.cfg"

choice
	prompt "TQMa8Xx RAM size"
	default TQMA8XX_RAM_1024MB if TQMA8XX_CPU_MX8QXP
	default TQMA8XX_RAM_1024MB if TQMA8XX_CPU_MX8DXP
	default TQMA8XX_RAM_512MB if TQMA8XX_CPU_MX8DX
	help
	  Select RAM size for TQMa8Xx

config TQMA8XX_RAM_512MB
	bool "TQMa8Xx with 512 MiB RAM"
	help
	  Select variant with 512 MiB RAM

config TQMA8XX_RAM_1024MB
	bool "TQMa8Xx with 1024 MiB RAM"
	help
	  Select variant with 1024 MiB RAM

config TQMA8XX_RAM_2048MB
	bool "TQMa8Xx with 2048 MiB RAM"
	help
	  Select variant with 2048 MiB RAM

endchoice

choice
	prompt "TQMa8Xx base board variant"
	default TQMA8XX_BB_MBA8XX
	help
	  Select base board for TQMa8Xx

config TQMA8XX_BB_MBA8XX
	bool "TQMa8Xx on MBa8Xx Starterkit"
	select TQC_ENVLOC
	select DM_SERIAL
	select FSL_LPUART
	select MII
	select DM_ETH
	select DM_ETH_PHY
	select FEC_MXC
	select PHYLIB
	select PHY_TI
	select USB
	select DM_USB
	select PHY
	select MXC_USB_OTG_HACTIVE
	select USB_XHCI_HCD
	select USB_XHCI_IMX8
	select USB_CDNS3
	select USB_GADGET
	select USB_CDNS3_GADGET
	select CDNS3_USB_PHY
	select SPL_SERIAL_SUPPORT
	select DM_PCA953X
	select CMD_FUSE
	select CMD_MII
	select CMD_PING
	select CMD_DHCP
	select CMD_NET
	help
	  Select the MBa8Xx starterkit. This features a GigE Phy, USB, SD-Card
	  etc.

endchoice

config DEFAULT_DEVICE_TREE
	default "imx8qxp-mba8xx" if TQMA8XX_CPU_MX8QXP && TQMA8XX_BB_MBA8XX
	default "imx8dxp-mba8xx" if TQMA8XX_CPU_MX8DXP && TQMA8XX_BB_MBA8XX

config DEFAULT_FDT_FILE
	default "imx8qxp-tqma8xqp-mba8xx.dtb" if TQMA8XX_CPU_MX8QXP && TQMA8XX_BB_MBA8XX
	default "imx8dxp-tqma8xdp-mba8xx.dtb" if TQMA8XX_CPU_MX8DXP && TQMA8XX_BB_MBA8XX

menu "TQMa8XQP boot device"

config TQMA8XX_BOOT_SDCARD
	bool "TQMa8Xx boot from SD / e-MMC"
	default "y"
	select SD_BOOT
	select ENV_IS_IN_MMC
	select SPL_MMC_SUPPORT
	select SUPPORT_EMMC_BOOT
	help
	  Select booting from SD / e-MMC. This selects MMC based env, SPL
	  support for MMC/SD and support for e-MMC boot partitions.
	  Additionally you should supply env offsets via devicetree config
	  node

config TQMBA8XX_BOOT_FSPI
	bool "TQMa8Xx boot from FlexSPI"
	default "y"
	select QSPI_BOOT
	select ENV_IS_IN_SPI_FLASH
	help
	  Select booting from QSPI NOR at FlexSPI port

endmenu

#
# default values for FLEXSPI NOR. Will be used also for environment from FLEXSPI
# if ENV_SPI_[BUS,CS,MODE,SPEED] are not used to overwrite.
#

config SF_DEFAULT_BUS
	default 0

config SF_DEFAULT_CS
	default 0

config SF_DEFAULT_SPEED
	default 40000000

config SF_DEFAULT_MODE
	default 0

config SYS_SPI_U_BOOT_OFFS
	default 0x200000

#
# environment settings: 32k, offset 4M (SPI NOR sector 64k), redundant env
# in SPI NOR @ 4M + 64k
#
# These should go here, when updating U-Boot to newer Version
#
config ENV_SIZE
	default 0x00008000

config ENV_SECT_SIZE
	default 0x00010000

config ENV_OFFSET
	default 0x00400000

config ENV_OFFSET_REDUND
	default 0x00410000

source "board/tqc/common/Kconfig"

endif
```
