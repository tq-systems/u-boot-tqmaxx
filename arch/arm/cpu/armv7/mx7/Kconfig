## arch/arm/cpu/armv7/mx7/Kconfig
```kconfig
if ARCH_MX7

config MX7
	bool
	default y

config MX7D
	select ROM_UNIFIED_SECTIONS
	bool

config MX7_SEC
	bool "boot linux only secure (needed for FSL Kernel)"
	default y

choice
	prompt "MX7 board select"
	optional

config TARGET_MX7DSABRESD
	bool "mx7dsabresd"
	select MX7D
	select DM
	select DM_THERMAL

config TARGET_MX7D_12X12_LPDDR3_ARM2
	bool "mx7d_12x12_lpddr3_arm2"
	select MX7D
	select DM
	select DM_THERMAL

config TARGET_MX7D_12X12_DDR3_ARM2
	bool "mx7d_12x12_ddr3_arm2"
	select MX7D
	select DM
	select DM_THERMAL

config TARGET_MX7D_19X19_LPDDR2_ARM2
	bool "mx7d_19x19_lpddr3_arm2"
	select MX7D
	select DM
	select DM_THERMAL

config TARGET_MX7D_19X19_LPDDR3_ARM2
	bool "mx7d_19x19_lpddr3_arm2"
	select MX7D
	select DM
	select DM_THERMAL

config TARGET_MX7D_19X19_DDR3_ARM2
	bool "mx7d_19x19_ddr3_arm2"
	select MX7D
	select DM
	select DM_THERMAL

config TARGET_TQMA7
	bool "tqma7"
	select MX7D
	select TQMA7
	select DM
	select DM_THERMAL
	select TQC_EEPROM
	select TQC_EMMC

endchoice

config SYS_SOC
	default "mx7"

source "board/freescale/mx7dsabresd/Kconfig"
source "board/freescale/mx7d_12x12_lpddr3_arm2/Kconfig"
source "board/freescale/mx7d_12x12_ddr3_arm2/Kconfig"
source "board/freescale/mx7d_19x19_lpddr3_arm2/Kconfig"
source "board/freescale/mx7d_19x19_ddr3_arm2/Kconfig"
source "board/tqc/tqma7/Kconfig"

endif
```

## arch/arm/cpu/armv8/imx8/Kconfig
```kconfig
if ARCH_IMX8

config HAVE_SC_FIRMWARE
	bool
	help
	  Have SCU on the SoC

config IMX_SMMU
	bool "Enable SMMU on i.MX8"
	help
	  Enable the SMMU for peripherals on i.MX8

config AHAB_BOOT
	bool "Support i.MX8 AHAB features"
	help
	  This option enables the support for AHAB secure boot.

config IMX8
	bool
	default y

config IMX8QM
	bool
	select HAVE_SC_FIRMWARE

config IMX8QXP
	bool
	select HAVE_SC_FIRMWARE

config SYS_SOC
	default "imx8"

choice
	prompt "MX8 board select"
	optional

config TARGET_IMX8QM_LPDDR4_ARM2
	bool "Support i.MX8QM lpddr4 validation board"
	select BOARD_LATE_INIT
	select IMX8QM

config TARGET_IMX8QM_DDR4_ARM2
	bool "Support i.MX8QM ddr4 validation board"
	select BOARD_LATE_INIT
	select IMX8QM

config TARGET_IMX8QM_MEK
	bool "Support i.MX8QM MEK board"
	select BOARD_LATE_INIT
	select IMX8QM

config TARGET_IMX8QXP_LPDDR4_ARM2
	bool "Support i.MX8QXP lpddr4 validation board"
	select BOARD_LATE_INIT
	select IMX8QXP

config TARGET_IMX8QXP_DDR3_ARM2
	bool "Support i.MX8QXP ddr3 validation board"
	select BOARD_LATE_INIT
	select IMX8QXP

config TARGET_IMX8QXP_MEK
	bool "Support i.MX8QXP MEK board"
	select BOARD_LATE_INIT
	select IMX8QXP

config TARGET_TQMA8QX
	bool "Support TQMa8xX board"
	select BOARD_LATE_INIT
	select IMX8QXP

config TARGET_TQMA8XX
	bool "Support TQMa8xX board"
	select BOARD_LATE_INIT
	select IMX8QXP
	select PSCI_RESET
	select IMX_BOOTAUX
	select ARM64_SUPPORT_AARCH32
	select SYS_MALLOC_F
	select ARCH_FIXUP_FDT_MEMORY
#	select MMC
#	select GENERIC_MMC
#	select DM_MMC
	select PINCTRL
	select PINCTRL_FULL
	select PINCTRL_GENERIC
	select PINMUX
	select PINCTRL_IMX8
	select POWER_DOMAIN

endchoice

source "board/freescale/imx8qm_arm2/Kconfig"
source "board/freescale/imx8qm_mek/Kconfig"
source "board/freescale/imx8qxp_arm2/Kconfig"
source "board/freescale/imx8qxp_mek/Kconfig"
source "board/freescale/tqma8qx/Kconfig"
source "board/tqc/tqma8xx/Kconfig"

endif
```

## arch/arm/mach-rmobile/Kconfig.64
```kconfig
if RCAR_GEN3

choice
	prompt "Select Target SoC"

config R8A7795
	bool "Renesas SoC R8A7795"

config R8A7796
	bool "Renesas SoC R8A7796"

config R8A77970
	bool "Renesas SoC R8A77970"

config R8A77990
	bool "Renesas SoC R8A77990"

config R8A77995
	bool "Renesas SoC R8A77995"

config R8A774A1
	bool "Renesas SoC R8A774A1"

config R8A774B1
	bool "Renesas SoC R8A774B1"

config R8A774C0
	bool "Renesas SoC R8A774C0"

config R8A774E1
	bool "Renesas SoC R8A774E1"

endchoice

choice
	prompt "Renesus ARM64 SoCs board select"
	optional

config TARGET_DRAAK
	bool "Draak board"
	help
          Support for Renesas R-Car Gen3 Draak platform

config TARGET_EAGLE
	bool "Eagle board"
	help
          Support for Renesas R-Car Gen3 Eagle platform

config TARGET_EBISU
	bool "Ebisu board"
	help
          Support for Renesas R-Car Gen3 Ebisu platform

config TARGET_SALVATOR_X
	bool "Salvator-X board"
	help
          Support for Renesas R-Car Gen3 platform

config TARGET_ULCB
	bool "ULCB board"
	help
          Support for Renesas R-Car Gen3 ULCB platform

config TARGET_EK874
	bool "EK874 board"
	help
          Support for Renesas RZG2E EK874 platform

config TARGET_HIHOPE_RZG2M
	bool "HiHope RZ/G2M board"
	help
          Support for RZG2M HiHope platform

config TARGET_HIHOPE_RZG2N
	bool "HiHope RZ/G2N board"
	help
          Support for RZG2N HiHope platform

config TARGET_HIHOPE_RZG2H
	bool "HiHope RZ/G2H board"
	help
          Support for RZG2H HiHope platform

config TARGET_TQMARZG2M_E_MBARZG2X
	bool "TQMaRZG2M board (8GiB)"
	select TQC_EEPROM
	help
          Support for TQMaRZG2M platform

config TARGET_TQMARZG2M_AA_MBARZG2X
	bool "TQMaRZG2M board (2GiB)"
	select TQC_EEPROM
	help
          Support for TQMaRZG2M platform

config TARGET_TQMARZG2H_C_MBARZG2X
	bool "TQMaRZG2H board (4GiB)"
	select TQC_EEPROM
	help
          Support for TQMaRZG2H platform

config TARGET_TQMARZG2N_B_MBARZG2X
	bool "TQMaRZG2N board (2GiB)"
	select TQC_EEPROM
	help
          Support for TQMaRZG2N platform
endchoice

config SYS_SOC
	default "rmobile"

source "board/renesas/draak/Kconfig"
source "board/renesas/eagle/Kconfig"
source "board/renesas/ebisu/Kconfig"
source "board/renesas/salvator-x/Kconfig"
source "board/renesas/ulcb/Kconfig"
source "board/renesas/ek874/Kconfig"
source "board/renesas/hihope-rzg2m/Kconfig"
source "board/renesas/hihope-rzg2n/Kconfig"
source "board/renesas/hihope-rzg2h/Kconfig"
source "board/tqc/tqmarzg2m_e-mbarzg2x/Kconfig"
source "board/tqc/tqmarzg2m_aa-mbarzg2x/Kconfig"
source "board/tqc/tqmarzg2h_c-mbarzg2x/Kconfig"
source "board/tqc/tqmarzg2n_b-mbarzg2x/Kconfig"

endif
```

## board/freescale/tqma8qx/Kconfig
```kconfig
if TARGET_TQMA8QX

config SYS_BOARD
	default "tqma8qx"

config SYS_VENDOR
	default "freescale"

config SYS_CONFIG_NAME
	default "tqma8qx"

source "board/freescale/common/Kconfig"

endif
```

## board/freescale/tqmtest/Kconfig
```kconfig
if TARGET_TQMTEST

config SYS_BOARD
	default "tqmtest"

config SYS_VENDOR
	default "freescale"

config SYS_CONFIG_NAME
	default "tqmtest"

source "board/freescale/common/Kconfig"

endif
```

## board/tq/tqma6/Kconfig
```kconfig
if TARGET_TQMA6

config SYS_BOARD
	default "tqma6"

config SYS_VENDOR
	default "tq"

config SYS_CONFIG_NAME
	default "tqma6"

choice
	prompt "TQMa6 SoC variant"
	default TQMA6Q
	help
	  select the TQMa6 module variant. The variants differing in the used
	  i.MX6 CPU type and DRAM

config TQMA6Q
	bool "TQMa6Q / TQMa6D"
	depends on MX6Q
	help
	  select TQMa6Q / TQMa6D with i.MX6Q/D and 1GiB DRAM

config TQMA6Q_2GB
	bool "TQMa6Q / TQMa6D (2GiB RAM)"
	depends on MX6Q
	help
	  select TQMa6Q / TQMa6D with i.MX6Q/D and 2GiB DRAM

config TQMA6QP
	bool "TQMaQP / TQMaDP"
	depends on MX6Q
	help
	  select TQMa6QP / TQMa6DP with i.MX6QP/DP and 1GiB DRAM

config TQMA6DL
	bool "TQMa6DL"
	depends on MX6DL
	help
	  select TQMa6DL with i.MX6DL and 1GiB DRAM

config TQMA6DL_2GB
	bool "TQMa6DL (2GiB RAM)"
	depends on MX6DL
	help
	  select TQMa6DL with i.MX6DL and 2GiB DRAM

config TQMA6S
	bool "TQMa6S"
	depends on MX6S
	help
	  select TQMa6S with i.MX6S and 512 MiB DRAM

endchoice

choice
	prompt "TQMa6 base board variant"
	default MBA6
	help
	  Select base board for TQMa6

config MBA6
	bool "TQMa6 on MBa6 Starterkit"
	select TQ_BB
	select TQ_EMMC
	select TQ_ENVLOC
	select TQ_SDMMC
	select USB
	select CMD_USB
	select USB_STORAGE
	select USB_HOST_ETHER
	select USB_ETHER_SMSC95XX
	select PHYLIB
	select PHY_MICREL
	select PHY_MICREL_KSZ90X1
	select MXC_UART
	select DM_I2C
	select DM_MMC
	select DM_SPI
	select DM_GPIO
	imply DM_SERIAL
	imply DM_ETH
	help
	  Select the MBa6 starterkit. This features a GigE Phy, USB, SD-Card
	  etc.

config WRU4
	bool "OHB WRU-IV"
	help
	  Select the OHB Systems AG WRU-IV baseboard.

endchoice

config TEXT_BASE
	default 0x2fc00000 if TQMA6S
	default 0x4fc00000 if TQMA6Q || TQMA6Q_2GB || TQMA6QP || TQMA6DL || TQMA6DL_2GB

config SPL_TEXT_BASE
	default 0x00908000

#
# environment settings: 64k, offset 1M (SPI Flash sector 64k), redundant env
# in SPI Flash @ 1M + 64k
#
config ENV_SIZE
	default 0x00010000

config ENV_SECT_SIZE
	default 0x00010000

config ENV_OFFSET
	default 0x00100000

config ENV_OFFSET_REDUND
	default 0x00110000

source "board/tq/common/Kconfig"

endif
```

## board/tq/tqma9xxx/Kconfig
```kconfig
if TARGET_TQMA9XXX

config SYS_BOARD
	default "tqma9xxx"

config SYS_VENDOR
	default "tq"

config SYS_CONFIG_NAME
	default "tqma9xxx"

config TQMA9XXX_DEFAULTS
	bool
	select TQ_EEPROM
	select TQ_RTC
	select TQ_SDMMC
	select TQ_BB
	imply I2C_EEPROM

choice
	prompt "TQMa9XXX SOM variant"
	default TQMA93XXLA
	help
	  Select board variant. There are multiple variants of the SOM
	  having the same features but needs slightly different config
	  options

config TQMA93XXLA
	bool "TQMA93XX LGA with LPDDR4X"
	select IMX93
	select IMX9_LPDDR4X
	select TQMA9XXX_DEFAULTS
	help
	  Select the TQMA93XX LGA variant. This features i.MX93 in
	  11x11 mm package with LPDDR4, PMIC, e-MMC and optionally
	  SPI-NOR, EEPROM, IMU, RTC, EEPROM

endchoice

choice
	prompt "TQMa9XXX mainboard variant"
	default TQMa9XXX_BB_MBA9XXXCA if TQMA93XXLA
	help
	  Select mainboard variant for the SOM. Default is the
	  starterkit.

config TQMa9XXX_BB_MBA9XXXCA
	bool "MBA9XXXCA starterkit"
	depends on TQMA93XXLA
	select DM_GPIO
	select ENV_IS_NOWHERE
	help
	  Select the MBA9XXXCA starterkit. The evaluation board can
	  demonstrate most of the features of the SOM and CPU

endchoice

source "board/tq/common/Kconfig"

endif
```

## board/tq/tqmls1043a/Kconfig
```kconfig
if TARGET_TQMLS1043A

config SYS_BOARD
	default "tqmls1043a"

config SYS_VENDOR
	default "tq"

config SYS_SOC
	default "fsl-layerscape"

config SYS_CONFIG_NAME
	default "tqmls1043a"

choice
	prompt "TQMLS1043A base board variant"
	default TQMLS1043A_BB_MBLS10XXA
	help
	  Select base board for TQMLS1043A

config TQMLS1043A_BB_MBLS10XXA
	bool "TQMLS1043A on MBLS10xxA Starterkit"
	select TQ_MBLS10XXA
	help
	  Select the MBLS10XXA starterkit. This features various SerDes configurations,
	  Ethernet, 10GBit Ethernet, USB, SD-Card and PCIe.

endchoice

source "board/tq/common/Kconfig"

endif
```

## board/tq/tqmls1046a/Kconfig
```kconfig
if TARGET_TQMLS1046A

config SYS_BOARD
	default "tqmls1046a"

config SYS_VENDOR
	default "tq"

config SYS_SOC
	default "fsl-layerscape"

config SYS_CONFIG_NAME
	default "tqmls1046a"

choice
	prompt "TQMLS1046A base board variant"
	default TQMLS1046A_BB_MBLS10XXA
	help
	  Select base board for TQMLS1046A

config TQMLS1046A_BB_MBLS10XXA
	bool "TQMLS1046A on MBLS10xxA Starterkit"
	select TQ_MBLS10XXA
	help
	  Select the MBLS10XXA starterkit. This features various SerDes configurations,
	  Ethernet, 10GBit Ethernet, USB, SD-Card and PCIe.

endchoice

source "board/tq/common/Kconfig"

endif
```

## board/tq/tqmls1088a/Kconfig
```kconfig
if TARGET_TQMLS1088A

config SYS_BOARD
	default "tqmls1088a"

config SYS_VENDOR
	default "tq"

config SYS_SOC
	default "fsl-layerscape"

config SYS_CONFIG_NAME
	default "tqmls1088a"

config VID
	bool "Enable TQMLS1088A VID setting"
	depends on I2C || DM_I2C
	help
	  This enables init_func_vid to be used in common/board_f.c.
	  For TQMLS1088A the function writes the correct voltage value to the
	  system controller. The new value is used after next POR.

choice
	prompt "TQMLS1088A base board variant"
	default TQMLS1088A_BB_MBLS10XXA
	help
	  Select base board for TQMLS1088A

config TQMLS1088A_BB_MBLS10XXA
	bool "TQMLS1088A on MBLS10xxA Starterkit"
	select TQ_MBLS10XXA
	help
	  Select the MBLS10XXA starterkit. This features various SerDes configurations,
	  Ethernet, 10GBit Ethernet, USB, SD-Card and PCIe.

endchoice

source "board/tq/common/Kconfig"

endif
```

## board/tqc/tqma335x/Kconfig
```kconfig
if TARGET_TQMA335X

config SYS_BOARD
	default "tqma335x"

config SYS_VENDOR
	default "tqc"

config SYS_SOC
	default "am33xx"

config SYS_CONFIG_NAME
	default "tqma335x"

config TQMA335X
	bool
	default y
	select TQC_EEPROM

choice
	prompt "TQMa335x[L] base board variant"
	default MBA335X
	help
		Select the base board used with the TQMa335x[L].

config MBA335X
	prompt "TQMa335x[L] on MBa335x Starterkit"
	bool
	help
	  Select the MBa335x starterkit as base for the TQMa335x[L].

endchoice

source "board/ti/common/Kconfig"
source "board/tqc/common/Kconfig"

endif
```

## board/tqc/tqma57xx/Kconfig
```kconfig
if TARGET_TQMA57XX

config SYS_BOARD
	default "tqma57xx"

config SYS_VENDOR
        default "tqc"

config SYS_CONFIG_NAME
        default "tqma57xx"

config TQMA57XX
	bool
	default y
	select TQC_EEPROM

config TQMA57XX_ECC
	bool "TQMa57xx module w/ ECC DDR"
	help
		Enable ECC memory (only when placed on module)

choice
	prompt "TQMa57xx base board variant"
	default MBA57XX
	help
		Select base board for TQMa57xx

config MBA57XX
	bool "TQMa57xx on MBa57xx Starterkit"
	help
		Select the MBa57xx starterkit. This features GigE Phy, USB,
		SD-Card	etc.

endchoice

config CONS_INDEX
        int "UART used for console"
        range 1 6
        default 3
        help
                The AM57x (and DRA7xx) SoC has a total of 6 UARTs available to
		it. Depending on your specific board you may want something
		other than UART3 here.

source "board/tqc/common/Kconfig"

config TI_COMMON_CMD_OPTIONS
	bool "Enable cmd options on TI platforms"
	imply CMD_ASKENV
	imply CMD_BOOTZ
	imply CRC32_VERIFY if ARCH_KEYSTONE
	imply CMD_DFU if USB_GADGET_DOWNLOAD
	imply CMD_DHCP
	imply CMD_EEPROM
	imply CMD_EXT2
	imply CMD_EXT4
	imply CMD_EXT4_WRITE
	imply CMD_FAT
	imply FAT_WRITE if CMD_FAT
	imply CMD_FS_GENERIC
	imply CMD_GPIO
	imply CMD_GPT
	imply CMD_I2C
	imply CMD_MII
	imply CMD_MMC
	imply CMD_PART
	imply CMD_PING
	imply CMD_PMIC if DM_PMIC
	imply CMD_REGULATOR if DM_REGULATOR
	imply CMD_SF if SPI_FLASH
	imply CMD_SPI
	imply CMD_TIME
	imply CMD_USB if USB

endif
```

## board/tqc/tqma64xxl/Kconfig
```kconfig
# SPDX-License-Identifier: GPL-2.0-or-later
#
# Copyright (C) 2017-2018 Texas Instruments Incorporated - http://www.ti.com/
# Copyright (c) 2020-2022 TQ-Systems GmbH <license@tq-group.com>, D-82229 Seefeld, Germany.

choice
	prompt "TQ-Systems TQMa64xxL"
	optional

config TARGET_AM64_A53_TQMA64XXL
	bool "TQ-Systems TQMa64xxL running on A53"
	select ARM64
	select SOC_K3_AM642
	select SPL_BOARD_INIT
	select BOARD_LATE_INIT
	select DM_I2C
	select TQ_EEPROM
	select TQ_VARD

config TARGET_AM64_R5_TQMA64XXL
	bool "TQ-Systems TQMa64xxL running on R5"
	select CPU_V7R
	select SYS_THUMB_BUILD
	select K3_LOAD_SYSFW
	select SOC_K3_AM642
	select RAM
	select SPL_RAM
	select K3_DDRSS
	select SPL_BOARD_INIT
	imply SYS_K3_SPL_ATF
	select DM_I2C
	select TQ_EEPROM
	select TQ_VARD

endchoice

if TARGET_AM64_A53_TQMA64XXL || TARGET_AM64_R5_TQMA64XXL

config SYS_BOARD
	default "tqma64xxl"

config SYS_VENDOR
	default "tqc"

choice
	prompt "TQ-Systems TQMa64xxL base board"

config TQMA64XXL_BOARD_MBAX4XXL
	bool "TQ-Systems MBaX4XxL"

endchoice

config SYS_CONFIG_NAME
	default "tqma64xxl_mbax4xxl" if TQMA64XXL_BOARD_MBAX4XXL

source "board/tqc/common/Kconfig"

endif

if TARGET_AM64_R5_TQMA64XXL

config SPL_LDSCRIPT
	default "arch/arm/mach-omap2/u-boot-spl.lds"

endif
```
